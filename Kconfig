## c28x/Kconfig.timer
```kconfig
config MACH_C28X_CPU_TIMER0
	bool "Timer 0"
config MACH_C28X_CPU_TIMER1
	bool "Timer 1"
config MACH_C28X_CPU_TIMER2
	bool "Timer 2"
	help
		Can't be dissabled used by port
```

## framaC/Kconfig
```kconfig
comment "Frama-C Settings"
config MACH_INCLUDE
	string
	default "-Imach/framaC/include"
config MACH_DEFINE_HEAP
	bool
	default y
config MACH_HAS_GPIO
	bool
	default y
config MACH_HAS_TIMER
	bool
	default y
config MACH_HAS_PWM
	bool
	default y
config MACH_HAS_CAPTURE
	bool
	default y
config MACH_HAS_ADC
	bool
	default y
config MACH_HAS_NEWLIB
	bool
	default y

config MACH_FRAMAC_GPIO
	bool "GPIO"
config MACH_FRAMAC_TIMER
	bool "Timer"
config MACH_FRAMAC_PWM
	bool "PWM"
config MACH_FRAMAC_CAPTURE
	bool "CAPTURE"
```

## imx6/Kconfig
```kconfig
comment "VF610 Settings"
config MAX_SYSCALL_INTERRUPT_PRIORITY
	hex
	default 0x20
config KERNEL_INTERRUPT_PRIORITY 
	hex
	default 0xf0

config MACH_INIT_STACK_SIZE
	int "Init Stack Size"
	default 600
	help
		Stack Size of Init Prozess. Stack size used by Interrupt and Init Prozess

config MACH_LD_SCRIPT
	string 
	default "mach/imx6/imx6sx.lds"

config MACH_INCLUDE
	string
	default "-Imach/imx6/include"
config MACH_DEFINE_HEAP
	bool
	default y
config MACH_USE_GENERIC_FAULT_HANDLER
	bool
	default y
config MACH_HAS_NVIC
	bool
	default y
config MACH_HAS_NEWLIB
	bool
	default y
config MACH_HAS_UART
	bool
	default y
config MACH_HAS_MAILBOX
	bool
	default y
config MACH_HAS_NET
	bool
	default y
	config MACH_NET_DEFAULT_ALGIN
		int
		default 512
config MACH_HAS_MAC
	bool
	default y
config MACH_HAS_TIMER
	bool
	default y
config MACH_HAS_RTC
	bool
	default y
menuconfig IMX_UART
	bool "IMX Uart"
	depends on UART
	default n
	help
		Enable IMX UART
	menuconfig IMX_UART_1
		bool "Enable UART 1"
		depends on IMX_UART
		help
			Enable UART 1
		choice
			prompt "TX Pin"
			depends on IMX_UART_1
			config IMX_UART_1_GPIO1_IO05
				bool "PAD_GPIO1_IO05"
			config IMX_UART_1_ENET2_COL
				bool "PAD_ENET2_COL"
		endchoice
		choice
			prompt "RX Pin"
			depends on IMX_UART_1
			config IMX_UART_1_GPIO1_IO04
				bool "PAD_GPIO1_IO04"
			config IMX_UART_1_ENET2_CRS
				bool "PAD_ENET2_CRS"
		endchoice
	menuconfig IMX_UART_2
		bool "Enable UART 2"
		depends on IMX_UART
		help 
			Enable UART 2
		choice
			prompt "TX Pin"
			depends on IMX_UART_2
			config IMX_UART_2_GPIO1_IO07
				bool "PAD_GPIO1_IO07"
			config IMX_UART_2_SD1_DATA0
				bool "PAD_SD1_DATA0"
		endchoice
		choice
			prompt "RX Pin"
			depends on IMX_UART_2
			config IMX_UART_2_GPIO1_IO06
				bool "PAD_GPIO1_IO06"
			config IMX_UART_2_SD1_DATA1
				bool "PAD_SD1_DATA1"
		endchoice
	menuconfig IMX_UART_3
		bool "Enable UART 3"
		depends on IMX_UART
		help
			Enable UART 3
		choice
			prompt "TX Pin"
			depends on IMX_UART_3
			config IMX_UART_3_NAND_DATA06
				bool "PAD_NAND_DATA06"
			config IMX_UART_3_QSPI1B_SCLK
				bool "PAD_QSPI1B_SCLK"
			config IMX_UART_3_SD3_DATA4
				bool "PAD_SD3_DATA4"
		endchoice
		choice
			prompt "RX Pin"
			depends on IMX_UART_3
			config IMX_UART_3_NAND_DATA07
				bool "PAD_NAND_DATA07"
			config IMX_UART_3_QSPI1B_SS0_B
				bool "PAD_QSPI1B_SS0_B"
			config IMX_UART_3_SD3_DATA5
				bool "PAD_SD3_DATA5"
		endchoice
	menuconfig IMX_UART_4
		bool "Enable UART 4"
		depends on IMX_UART
		help
			Enable UART 4
		choice
			prompt "TX Pin"
			depends on IMX_UART_4
			config IMX_UART_4_CSI_MCLK
				bool "PAD_CSI_MCLK"
			config IMX_UART_4_SD2_DATA0
				bool "PAD_SD2_DATA0"
			config IMX_UART_4_SD3_DATA4
				bool "PAD_SD3_DATA4"
		endchoice
		choice
			prompt "RX Pin"
			depends on IMX_UART_4
			config IMX_UART_4_CSI_PIXCLK
				bool "PAD_CSI_PIXCLK"
			config IMX_UART_4_SD2_DATA1
				bool "PAD_SD2_DATA1"
			config IMX_UART_4_SD3_CMD
				bool "PAD_SD3_CMD"
		endchoice
	menuconfig IMX_UART_5
		bool "Enable UART 5"
		depends on IMX_UART
		help
			Enable UART 5
		choice
			prompt "TX Pin"
			depends on IMX_UART_5
			config IMX_UART_5_KEY_ROW3
				bool "PAD_KEY_ROW3"
			config IMX_UART_5_SD4_DATA4
				bool "PAD_SD4_DATA4"
		endchoice
		choice
			prompt "RX Pin"
			depends on IMX_UART_5
			config IMX_UART_5_KEY_COL3
				bool "PAD_KEY_COL3"
			config IMX_UART_5_SD4_DATA5
				bool "PAD_SD4_DATA5"
		endchoice
menuconfig IMX_MAILBOX
	bool "IMX Mailbox"
	depends on MAILBOX
	default n
	help
		IMX Interprocessor Maibox
	config IMX_MAILBOX_0
		bool "IMX Mailbox 0"
		depends on IMX_MAILBOX
	config IMX_MAILBOX_1
		bool "IMX Mailbox 1"
		depends on IMX_MAILBOX
	config IMX_MAILBOX_2
		bool "IMX Mailbox 2"
		depends on IMX_MAILBOX
	config IMX_MAILBOX_3
		bool "IMX Mailbox 3"
		depends on IMX_MAILBOX
menuconfig IMX_ENET
	bool "IMX Enet"
	depends on MAC
	depends on SUPPORT_DYNAMIC_ALLOCATION
	select TIMER
	default n
	help
		IMX Ethenet driver
	config IMX_ENET_BUFFERSIZE
		int "Buffersize (shall power of two)"
		depends on IMX_ENET
		default 512
		help
			Buffersize (shall power of two)

			The Buffer size is CONFIG_IMX_ENET_BUFFSIZE * 1536 Bytes * 3 Queue * 2(RX + TX)
			For Example CONFIG_IMX_ENET_BUFFSIZE is 512 
			4.5 MB Space is allocated
	config IMX_ENET_PROMISCUOUS_MODE
		bool "Set ENet in Permoiscous mode"
		default y
		depends on IMX_ENET
	config IMX_ENET_IEEE1588
		bool "Enable IEEE1588 Timer (not working!)"
		default y
		depends on IMX_ENET
		depends on RTC
		config IMX_ENET_IEEE1588_SLAVE
			bool "Enable Slave mode"
			default n
			depends on IMX_ENET_IEEE1588
	config IMX_ENET1
		bool "ENET1"
		depends on IMX_ENET
		default n
	config IMX_ENET2
		bool "ENET2"
		depends on IMX_ENET
		default n
```

## kv4x/Kconfig
```kconfig
comment "NXP KV4x Settings"
choice 
	prompt "Select Prozessor Type"
	config MKV46F128VLH16
		bool "NPX MKV46F128VLH16"
	config MKV46F128VLL16
		bool "NPX MKV46F128VLL16"
	config MKV46F256VLH16
		bool "NPX MKV46F256VLH16"
	config MKV46F256VLL16
		bool "NPX MKV46F256VLL16"
endchoice
config MAX_SYSCALL_INTERRUPT_PRIORITY
	hex
	default 0x20
config KERNEL_INTERRUPT_PRIORITY 
	hex
	default 0xf0
config MACH_INIT_STACK_SIZE
	int "Init Stack Size"
	default 600
	help
		Stack Size of Init Prozess. Stack size used by Interrupt and Init Prozess
config MACH_LD_SCRIPT
	string 
	default "mach/kv4x/kv4x.lds"
config MACH_INCLUDE
	string
	default "-Imach/kv4x/include -Imach/nxp/include"
config MACH_DEFINE_HEAP
	bool
	default y
config MACH_USE_GENERIC_FAULT_HANDLER
	bool
	default y
config MACH_HAS_NEWLIB
	bool
	default y
config MACH_HAS_NVIC
	bool
	default y
config MACH_HAS_GPIO
	bool
	default y
config MACH_HAS_TIMER
	bool
	default y
config MACH_HAS_PWM
	bool
	default y
config MACH_HAS_CAPTURE
	bool
	default y
config MACH_HAS_CAN
	bool
	default y
config USE_NXP_LIB
	bool
	default y
config MACH_NEED_GENERIC_SYSINIT
	bool
	default y
config ARCH_SYSINIT_EARLY_INIT
	bool
	default y
config MACH_NEED_ARM_INIT
	bool
	default y

config MACH_KV4X_DISABLE_WDOG
	bool "Disable Watchdog at startup"
	default y
# GPIO Subsytem is use by muxing system
config KV4X_GPIO
	bool
	default y
	select GPIO
	select NXP_GPIO
	select NXP_GPIO_MUX
	config GPIO_PORT_COUNT
		int
		depends on NXP_GPIO
		default 5
menuconfig EXTERNAL_OSCILLATOR
	bool "Activate PLL / FLL"
	default y
if EXTERNAL_OSCILLATOR=y
	comment "Waring: PLL Setting could damage Target" 
	choice
		prompt "Sleect Soruce"
		config MACH_MKV4X_EXTERNAL
			bool "External Mode (Max Freq: 148MHz)"
		config MACH_MKV4X_INTERNAL
			bool "Internal Mode (Max Freq: 100Mhz)"
	endchoice
	if MACH_MKV4X_EXTERNAL=y
		config MACH_MKV4X_EXTERNAL_REF_CLOCK
			bool "Use External reference clock"
			default no
		comment "External Crystal / Resonator Settings"
		config MACH_OSCILLATOR_SPEED
			int "External Oscillator / CLOCK Speed (Hz)"
			default 8000000
		choice
			prompt "ERCLK prescaler"
			config MACH_MKV4X_ERCLK_1
				bool "/1"
			config MACH_MKV4X_ERCLK_2
				bool "/2"
			config MACH_MKV4X_ERCLK_4
				bool "/4"
			config MACH_MKV4X_ERCLK_8
				bool "/8"
		endchoice
		if MACH_MKV4X_EXTERNAL_REF_CLOCK=n
			config MACH_MKV4X_OSC_CAP2P
				bool "Oscillator 2 pF Capacitor Load Configure"
			config MACH_MKV4X_OSC_CAP4P
				bool "Oscillator 4 pF Capacitor Load Configure"
			config MACH_MKV4X_OSC_CAP8P
				bool "Oscillator 8 pF Capacitor Load Configure"
			config MACH_MKV4X_OSC_CAP16P
				bool "Oscillator 16 pF Capacitor Load Configure"
			choice
				prompt "High Gain Oscillator Select"
				config MACH_MKV4X_OSC_HIGH_GAIN
					bool "high-gain operation"
				config MACH_MKV4X_OSC_LOW_POWER
					bool "low-power operation"
			endchoice
		endif
	endif
	comment "PLL / FLL Settings"
	choice
		prompt "Select Frequency Range"
		config MACH_MKV4X_RANGE_VERY_HIGH
			bool "Very high frequency range"
		config MACH_MKV4X_RANGE_LOW
			bool "Low frequency range"
		config MACH_MKV4X_RANGE_HIGH
			bool "High frequency range"
	endchoice
	comment "FLL Frequency ((External Frequency) / FRDIV) must between 31.25 kHz to 39.0625 kHz"
	choice
		prompt "Select FLL External Reference Divider"
		depends on MACH_MKV4X_EXTERNAL
		config MACH_MKV4X_FRDIV_256
			bool "/256"
			depends on !MACH_MKV4X_RANGE_LOW
		config MACH_MKV4X_FRDIV_LOW_1
			bool "/1"
			depends on MACH_MKV4X_RANGE_LOW
		config MACH_MKV4X_FRDIV_LOW_2
			bool "/2"
			depends on MACH_MKV4X_RANGE_LOW
		config MACH_MKV4X_FRDIV_LOW_4
			bool "/4"
			depends on MACH_MKV4X_RANGE_LOW
		config MACH_MKV4X_FRDIV_LOW_8
			bool "/8"
			depends on MACH_MKV4X_RANGE_LOW
		config MACH_MKV4X_FRDIV_LOW_16
			bool "/16"
			depends on MACH_MKV4X_RANGE_LOW
		config MACH_MKV4X_FRDIV_LOW_32
			bool "/32"
			depends on MACH_MKV4X_RANGE_LOW
		config MACH_MKV4X_FRDIV_LOW_64
			bool "/64"
			depends on MACH_MKV4X_RANGE_LOW
		config MACH_MKV4X_FRDIV_LOW_128
			bool "/128"
			depends on MACH_MKV4X_RANGE_LOW
		config MACH_MKV4X_FRDIV_32
			bool "/32"
			depends on !MACH_MKV4X_RANGE_LOW
		config MACH_MKV4X_FRDIV_64
			bool "/64"
			depends on !MACH_MKV4X_RANGE_LOW
		config MACH_MKV4X_FRDIV_128
			bool "/128"
			depends on !MACH_MKV4X_RANGE_LOW
		config MACH_MKV4X_FRDIV_512
			bool "/512"
			depends on !MACH_MKV4X_RANGE_LOW
		config MACH_MKV4X_FRDIV_1024
			bool "/1024"
			depends on !MACH_MKV4X_RANGE_LOW
		config MACH_MKV4X_FRDIV_1280
			bool "/1280"
			depends on !MACH_MKV4X_RANGE_LOW
		config MACH_MKV4X_FRDIV_1536
			bool "/1536"
			depends on !MACH_MKV4X_RANGE_LOW
	endchoice
	choice
		prompt "DRST_DRS Range Select"
		config MACH_MKV4X_DRST_DRS_0
			bool "Low range (FLL Factor: 640 / 732, DCO Range: 20–25 MHz"
		config MACH_MKV4X_DRST_DRS_1
			bool "Mid range (FLL Factor: 1280 / 1464 DCO Range: 40–50 MHz"
		config MACH_MKV4X_DRST_DRS_2
			bool "Mid-high range (FLL Factor: 1920 / 2197 DCO Range: 60–75 MHz"
		config MACH_MKV4X_DRST_DRS_3
			bool "High range (FLL Factor: 2560 / 2929 DCO Range: 80–100 MHz)"
	endchoice
	config MACH_MKV4X_DMX32
		bool "DCO Input Frequency is fine-tuned to 32.768 kHz"
	comment "PLL Settings"
	if MACH_MKV4X_EXTERNAL=y
		choice
			prompt "PLL External Reference Divider (output between 8 MHz to 16 MHz)"
			config MACH_MKV4X_PRDIV_1
				bool "/1"
			config MACH_MKV4X_PRDIV_2
				bool "/2"
			config MACH_MKV4X_PRDIV_3
				bool "/3"
			config MACH_MKV4X_PRDIV_4
				bool "/4"
			config MACH_MKV4X_PRDIV_5
				bool "/5"
			config MACH_MKV4X_PRDIV_6
				bool "/6"
			config MACH_MKV4X_PRDIV_7
				bool "/7"
			config MACH_MKV4X_PRDIV_8
				bool "/8"
		endchoice

		choice
			prompt "VCO Multiplier"
			config MACH_MKV4X_VDIV_42
				bool "x42"
			config MACH_MKV4X_VDIV_16
				bool "x16"
			config MACH_MKV4X_VDIV_17
				bool "x17"
			config MACH_MKV4X_VDIV_18
				bool "x18"
			config MACH_MKV4X_VDIV_19
				bool "x19"
			config MACH_MKV4X_VDIV_20
				bool "x20"
			config MACH_MKV4X_VDIV_21
				bool "x21"
			config MACH_MKV4X_VDIV_22
				bool "x22"
			config MACH_MKV4X_VDIV_23
				bool "x23"
			config MACH_MKV4X_VDIV_24
				bool "x24"
			config MACH_MKV4X_VDIV_25
				bool "x25"
			config MACH_MKV4X_VDIV_26
				bool "x26"
			config MACH_MKV4X_VDIV_27
				bool "x27"
			config MACH_MKV4X_VDIV_28
				bool "x28"
			config MACH_MKV4X_VDIV_29
				bool "x29"
			config MACH_MKV4X_VDIV_30
				bool "x30"
			config MACH_MKV4X_VDIV_31
				bool "x31"
			config MACH_MKV4X_VDIV_32
				bool "x32"
			config MACH_MKV4X_VDIV_33
				bool "x33"
			config MACH_MKV4X_VDIV_34
				bool "x34"
			config MACH_MKV4X_VDIV_35
				bool "x35"
			config MACH_MKV4X_VDIV_36
				bool "x36"
			config MACH_MKV4X_VDIV_37
				bool "x37"
			config MACH_MKV4X_VDIV_38
				bool "x38"
			config MACH_MKV4X_VDIV_39
				bool "x39"
			config MACH_MKV4X_VDIV_40
				bool "x40"
			config MACH_MKV4X_VDIV_41
				bool "x41"
			config MACH_MKV4X_VDIV_43
				bool "x43"
			config MACH_MKV4X_VDIV_44
				bool "x44"
			config MACH_MKV4X_VDIV_45
				bool "x45"
			config MACH_MKV4X_VDIV_46
				bool "x46"
			config MACH_MKV4X_VDIV_47
				bool "x47"
		endchoice
	endif
	comment "Clock Settings"
	choice
		prompt "SysClk divider"
		config MACH_MKV4X_OUTDIV1_1
			bool "/1"
		config MACH_MKV4X_OUTDIV1_2
			bool "/2"
		config MACH_MKV4X_OUTDIV1_3
			bool "/3"
		config MACH_MKV4X_OUTDIV1_4
			bool "/4"
		config MACH_MKV4X_OUTDIV1_5
			bool "/5"
		config MACH_MKV4X_OUTDIV1_6
			bool "/6"
		config MACH_MKV4X_OUTDIV1_7
			bool "/7"
		config MACH_MKV4X_OUTDIV1_8
			bool "/8"
		config MACH_MKV4X_OUTDIV1_9
			bool "/9"
		config MACH_MKV4X_OUTDIV1_10
			bool "/10"
		config MACH_MKV4X_OUTDIV1_11
			bool "/12"
		config MACH_MKV4X_OUTDIV1_13
			bool "/13"
		config MACH_MKV4X_OUTDIV1_14
			bool "/14"
		config MACH_MKV4X_OUTDIV1_15
			bool "/15"
		config MACH_MKV4X_OUTDIV1_16
			bool "/16"
	endchoice
	choice
		prompt "Fast Perf Clk divider"
		config MACH_MKV4X_OUTDIV2_2
			bool "/2"
		config MACH_MKV4X_OUTDIV2_1
			bool "/1"
		config MACH_MKV4X_OUTDIV2_3
			bool "/3"
		config MACH_MKV4X_OUTDIV2_4
			bool "/4"
		config MACH_MKV4X_OUTDIV2_5
			bool "/5"
		config MACH_MKV4X_OUTDIV2_6
			bool "/6"
		config MACH_MKV4X_OUTDIV2_7
			bool "/7"
		config MACH_MKV4X_OUTDIV2_8
			bool "/8"
		config MACH_MKV4X_OUTDIV2_9
			bool "/9"
		config MACH_MKV4X_OUTDIV2_10
			bool "/10"
		config MACH_MKV4X_OUTDIV2_11
			bool "/12"
		config MACH_MKV4X_OUTDIV2_13
			bool "/13"
		config MACH_MKV4X_OUTDIV2_14
			bool "/14"
		config MACH_MKV4X_OUTDIV2_15
			bool "/15"
		config MACH_MKV4X_OUTDIV2_16
			bool "/16"
	endchoice
	choice
		prompt "Flash Clock divider"
		config MACH_MKV4X_OUTDIV4_7
			bool "/7"
		config MACH_MKV4X_OUTDIV4_1
			bool "/1"
		config MACH_MKV4X_OUTDIV4_2
			bool "/2"
		config MACH_MKV4X_OUTDIV4_3
			bool "/3"
		config MACH_MKV4X_OUTDIV4_4
			bool "/4"
		config MACH_MKV4X_OUTDIV4_5
			bool "/5"
		config MACH_MKV4X_OUTDIV4_6
			bool "/6"
		config MACH_MKV4X_OUTDIV4_8
			bool "/8"
		config MACH_MKV4X_OUTDIV4_9
			bool "/9"
		config MACH_MKV4X_OUTDIV4_10
			bool "/10"
		config MACH_MKV4X_OUTDIV4_11
			bool "/12"
		config MACH_MKV4X_OUTDIV4_13
			bool "/13"
		config MACH_MKV4X_OUTDIV4_14
			bool "/14"
		config MACH_MKV4X_OUTDIV4_15
			bool "/15"
		config MACH_MKV4X_OUTDIV4_16
			bool "/16"
	endchoice
endif
menuconfig MACH_KV4X_FLEXCAN
	depends on CAN
	select NXP_FLEXCAN
	bool "Activate FlexCAN"
	default n
	if MACH_KV4X_FLEXCAN
	source mach/kv4x/Kconfig.can
	endif
menuconfig MACH_KV4X_FLEXTIMER
	depends on TIMER
	select NXP_FLEXTIMER
	select NXP_FLEXTIMER_VERSION_1
	bool "Activate Flextimer"
	default n
	if MACH_KV4X_FLEXTIMER
	source mach/kv4x/Kconfig.timer
	endif
```
