## am57xx/Kconfig.timer
```kconfig
if AM57xx_TIMER=y
config AM57xx_TIMER_DEBUG
	bool "Timer Debug"
	default n
config AM57xx_TIMER_PWM
	bool "Enable PWM Support"
	depends on PWM
	default n
config AM57xx_TIMER_CAPTURE
	bool "Enable Capture Support"
	depends on CAPTURE
	default n
config AM57xx_TIMER1
	bool "Timer 1"
	default n
	if AM57xx_TIMER1 = y
		config AM57xx_TIMER1_PWM
			bool "PWM Support"
			depends on AM57xx_TIMER_PWM
			default n
		config AM57xx_TIMER1_CAPTURE
			bool "Capture Support"
			depends on AM57xx_TIMER_CAPTURE
			default n
		choice
			prompt "PWM / Capture Pin"
			depends on AM57xx_TIMER1_PWM || AM57xx_TIMER1_CAPTURE
			config AM57xx_TIMER1_GPMC_BEN1
				bool "GPMC_BEN1"
				depends on AM57xx_TIMER1_PWM || AM57xx_TIMER1_CAPTURE
			config AM57xx_TIMER1_GPIO6_14
				bool "GPIO6_14"
				depends on AM57xx_TIMER1_PWM || AM57xx_TIMER1_CAPTURE

		endchoice
	endif
config AM57xx_TIMER2
	bool "Timer 2"
	default n
	if AM57xx_TIMER2 = y
		config AM57xx_TIMER2_PWM
			bool "PWM Support"
			depends on AM57xx_TIMER_PWM
			default n
		config AM57xx_TIMER2_CAPTURE
			bool "Capture Support"
			depends on AM57xx_TIMER_CAPTURE
			default n
		choice
			prompt "PWM / Capture Pin"
			depends on AM57xx_TIMER2_PWM || AM57xx_TIMER2_CAPTURE
			config AM57xx_TIMER2_GPIO6_15
				bool "GPIO6_15"
				depends on AM57xx_TIMER2_PWM || AM57xx_TIMER2_CAPTURE
			config AM57xx_TIMER2_GPMC_BEN0
				bool "GPMC_BEN0"
				depends on AM57xx_TIMER2_PWM || AM57xx_TIMER2_CAPTURE
		endchoice
	endif
config AM57xx_TIMER3
	bool "Timer 3"
	default n
	if AM57xx_TIMER3 = y
		config AM57xx_TIMER3_PWM
			bool "PWM Support"
			depends on AM57xx_TIMER_PWM
			default n
		config AM57xx_TIMER3_CAPTURE
			bool "Capture Support"
			depends on AM57xx_TIMER_CAPTURE
			default n
		choice
			prompt "PWM / Capture Pin"
			depends on AM57xx_TIMER3_PWM || AM57xx_TIMER3_CAPTURE
			config AM57xx_TIMER3_GPMC_ADVN_ALE
				bool "GPMC_ADVN_ALE"
				depends on AM57xx_TIMER3_PWM || AM57xx_TIMER3_CAPTURE
			config AM57xx_TIMER3_GPIO6_16
				bool "GPIO6_16"
				depends on AM57xx_TIMER3_PWM || AM57xx_TIMER3_CAPTURE
		endchoice
	endif
config AM57xx_TIMER4
	bool "Timer 4"
	default n
	if AM57xx_TIMER4 = y
		config AM57xx_TIMER4_PWM
			bool "PWM Support"
			depends on AM57xx_TIMER_PWM
			default n
		config AM57xx_TIMER4_CAPTURE
			bool "Capture Support"
			depends on AM57xx_TIMER_CAPTURE
			default n
		choice
			prompt "PWM / Capture Pin"
			depends on AM57xx_TIMER4_PWM || AM57xx_TIMER4_CAPTURE
			config AM57xx_TIMER4_GPMC_CLK
				bool "GPMC_CLK"
				depends on AM57xx_TIMER4_PWM || AM57xx_TIMER4_CAPTURE
			config AM57xx_TIMER4_MCASP1_AXR7
				bool "MCASP1_AXR7"
				depends on AM57xx_TIMER4_PWM || AM57xx_TIMER4_CAPTURE
		endchoice
	endif
config AM57xx_TIMER5
	bool "Timer 5"
	default n
	if AM57xx_TIMER5 = y
		config AM57xx_TIMER5_PWM
			bool "PWM Support"
			depends on AM57xx_TIMER_PWM
			default n
		config AM57xx_TIMER5_CAPTURE
			bool "Capture Support"
			depends on AM57xx_TIMER_CAPTURE
			default n
		choice
			prompt "PWM / Capture Pin"
			depends on AM57xx_TIMER5_PWM || AM57xx_TIMER5_CAPTURE
			config AM57xx_TIMER5_GPMC_A15
				bool "GPMC_A15"
				depends on AM57xx_TIMER5_PWM || AM57xx_TIMER5_CAPTURE
			config AM57xx_TIMER5_MCASP1_AXR8
				bool "MCASP1_AXR8"
				depends on AM57xx_TIMER5_PWM || AM57xx_TIMER5_CAPTURE
		endchoice
	endif
config AM57xx_TIMER6
	bool "Timer 6"
	default n
	if AM57xx_TIMER6 = y
		config AM57xx_TIMER6_PWM
			bool "PWM Support"
			depends on AM57xx_TIMER_PWM
			default n
		config AM57xx_TIMER6_CAPTURE
			bool "Capture Support"
			depends on AM57xx_TIMER_CAPTURE
			default n
		choice
			prompt "PWM / Capture Pin"
			depends on AM57xx_TIMER6_PWM || AM57xx_TIMER6_CAPTURE
			config AM57xx_TIMER6_GPMC_A14
				bool "GPMC_A14"
				depends on AM57xx_TIMER6_PWM || AM57xx_TIMER6_CAPTURE
			config AM57xx_TIMER6_MCASP1_AXR9
				bool "MCASP1_AXR9"
				depends on AM57xx_TIMER6_PWM || AM57xx_TIMER6_CAPTURE
		endchoice
	endif
config AM57xx_TIMER7
	bool "Timer 7"
	default n
	if AM57xx_TIMER7 = y
		config AM57xx_TIMER7_PWM
			bool "PWM Support"
			depends on AM57xx_TIMER_PWM
			default n
		config AM57xx_TIMER7_CAPTURE
			bool "Capture Support"
			depends on AM57xx_TIMER_CAPTURE
			default n
		choice
			prompt "PWM / Capture Pin"
			depends on AM57xx_TIMER7_PWM || AM57xx_TIMER7_CAPTURE
			config AM57xx_TIMER7_GPMC_A13
				bool "GPMC_A13"
				depends on AM57xx_TIMER7_PWM || AM57xx_TIMER7_CAPTURE
			config AM57xx_TIMER7_MCASP1_AXR10
				bool "MCASP1_AXR10"
				depends on AM57xx_TIMER7_PWM || AM57xx_TIMER7_CAPTURE
		endchoice
	endif
config AM57xx_TIMER8
	bool "Timer 8"
	default n
	if AM57xx_TIMER8 = y
		config AM57xx_TIMER8_PWM
			bool "PWM Support"
			depends on AM57xx_TIMER_PWM
			default n
		config AM57xx_TIMER8_CAPTURE
			bool "Capture Support"
			depends on AM57xx_TIMER_CAPTURE
			default n
		choice
			prompt "PWM / Capture Pin"
			depends on AM57xx_TIMER8_PWM || AM57xx_TIMER8_CAPTURE
			config AM57xx_TIMER8_GPMC_A12
				bool "GPMC_A12"
				depends on AM57xx_TIMER8_PWM || AM57xx_TIMER8_CAPTURE
			config AM57xx_TIMER8_MCASP1_AXR11
				bool "MCASP1_AXR11"
				depends on AM57xx_TIMER8_PWM || AM57xx_TIMER8_CAPTURE
		endchoice
	endif
config AM57xx_TIMER9
	bool "Timer 9"
	default n
	if AM57xx_TIMER9 = y
		config AM57xx_TIMER9_PWM
			bool "PWM Support"
			depends on AM57xx_TIMER_PWM
			default n
		config AM57xx_TIMER9_CAPTURE
			bool "Capture Support"
			depends on AM57xx_TIMER_CAPTURE
			default n
		choice
			prompt "PWM / Capture Pin"
			depends on AM57xx_TIMER9_PWM || AM57xx_TIMER9_CAPTURE
			config AM57xx_TIMER9_MCASP1_AXR12
				bool "MCASP1_AXR12"
				depends on AM57xx_TIMER9_PWM || AM57xx_TIMER9_CAPTURE
			config AM57xx_TIMER9_GPMC_A11
				bool "GPMC_A11"
				depends on AM57xx_TIMER9_PWM || AM57xx_TIMER9_CAPTURE
		endchoice
	endif
config AM57xx_TIMER10
	bool "Timer 10"
	default n
	if AM57xx_TIMER10 = y
		config AM57xx_TIMER10_PWM
			bool "PWM Support"
			depends on AM57xx_TIMER_PWM
			default n
		config AM57xx_TIMER10_CAPTURE
			bool "Capture Support"
			depends on AM57xx_TIMER_CAPTURE
			default n
		choice
			prompt "PWM / Capture Pin"
			depends on AM57xx_TIMER10_PWM || AM57xx_TIMER10_CAPTURE
			config AM57xx_TIMER10_MCASP1_AXR13
				bool "MCASP1_AXR13"
				depends on AM57xx_TIMER10_PWM || AM57xx_TIMER10_CAPTURE
			config AM57xx_TIMER10_GPMC_A10
				bool "GPMC_A10"
				depends on AM57xx_TIMER10_PWM || AM57xx_TIMER10_CAPTURE
		endchoice
	endif
config AM57xx_TIMER11
	bool "Timer 11"
	default n
	if AM57xx_TIMER11 = y
		config AM57xx_TIMER11_PWM
			bool "PWM Support"
			depends on AM57xx_TIMER_PWM
			default n
		config AM57xx_TIMER11_CAPTURE
			bool "Capture Support"
			depends on AM57xx_TIMER_CAPTURE
			default n
		choice
			prompt "PWM / Capture Pin"
			depends on AM57xx_TIMER11_PWM || AM57xx_TIMER11_CAPTURE
			config AM57xx_TIMER11_MCASP1_AXR14
				bool "MCASP1_AXR14"
				depends on AM57xx_TIMER11_PWM || AM57xx_TIMER11_CAPTURE
			config AM57xx_TIMER11_GPMC_A9
				bool "GPMC_A9"
				depends on AM57xx_TIMER11_PWM || AM57xx_TIMER11_CAPTURE
		endchoice
	endif
config AM57xx_TIMER12
	bool "Timer 12"
	default n
	if AM57xx_TIMER12 = y
		config AM57xx_TIMER12_PWM
			bool "PWM Support"
			depends on AM57xx_TIMER_PWM
			default n
		config AM57xx_TIMER12_CAPTURE
			bool "Capture Support"
			depends on AM57xx_TIMER_CAPTURE
			default n
		choice
			prompt "PWM / Capture Pin"
			depends on AM57xx_TIMER12_PWM || AM57xx_TIMER12_CAPTURE
			config AM57xx_TIMER12_MCASP1_AXR15
				bool "MCASP1_AXR15"
				depends on AM57xx_TIMER12_PWM || AM57xx_TIMER12_CAPTURE
			config AM57xx_TIMER12_GPMC_A8
				bool "GPMC_A8"
				depends on AM57xx_TIMER12_PWM || AM57xx_TIMER12_CAPTURE
		endchoice
	endif
config AM57xx_TIMER13
	bool "Timer 13"
	default n
	if AM57xx_TIMER13 = y
		config AM57xx_TIMER13_PWM
			bool "PWM Support"
			depends on AM57xx_TIMER_PWM
			default n
		config AM57xx_TIMER13_CAPTURE
			bool "Capture Support"
			depends on AM57xx_TIMER_CAPTURE
			default n
		choice
			prompt "PWM / Capture Pin"
			depends on AM57xx_TIMER13_PWM || AM57xx_TIMER13_CAPTURE
			config AM57xx_TIMER13_VIN1A_VSYNC0
				bool "VIN1A_VSYNC0"
				depends on AM57xx_TIMER13_PWM || AM57xx_TIMER13_CAPTURE
			config AM57xx_TIMER13_XREF_CLK0
				bool "XREF_CLK0"
				depends on AM57xx_TIMER13_PWM || AM57xx_TIMER13_CAPTURE
		endchoice
	endif
config AM57xx_TIMER14
	bool "Timer 14"
	default n
	if AM57xx_TIMER14 = y
		config AM57xx_TIMER14_PWM
			bool "PWM Support"
			depends on AM57xx_TIMER_PWM
			default n
		config AM57xx_TIMER14_CAPTURE
			bool "Capture Support"
			depends on AM57xx_TIMER_CAPTURE
			default n
		choice
			prompt "PWM / Capture Pin"
			depends on AM57xx_TIMER14_PWM || AM57xx_TIMER14_CAPTURE
			config AM57xx_TIMER14_XREF_CLK1
				bool "XREF_CLK1"
				depends on AM57xx_TIMER14_PWM || AM57xx_TIMER14_CAPTURE
			config AM57xx_TIMER14_VIN1A_HSYNC0
				bool "VIN1A_HSYNC0"
				depends on AM57xx_TIMER14_PWM || AM57xx_TIMER14_CAPTURE
		endchoice
	endif
config AM57xx_TIMER15
	bool "Timer 15"
	default n
	if AM57xx_TIMER15 = y
		config AM57xx_TIMER15_PWM
			bool "PWM Support"
			depends on AM57xx_TIMER_PWM
			default n
		config AM57xx_TIMER15_CAPTURE
			bool "Capture Support"
			depends on AM57xx_TIMER_CAPTURE
			default n
		choice
			prompt "PWM / Capture Pin"
			depends on AM57xx_TIMER15_PWM || AM57xx_TIMER15_CAPTURE
			config AM57xx_TIMER15_VIN1A_FLD0
				bool "VIN1A_FLD0"
				depends on AM57xx_TIMER15_PWM || AM57xx_TIMER15_CAPTURE
			config AM57xx_TIMER15_USB2_DRVVBUS
				bool "USB2_DRVVBUS"
				depends on AM57xx_TIMER15_PWM || AM57xx_TIMER15_CAPTURE
		endchoice
	endif
config AM57xx_TIMER16
	bool "Timer 16"
	default n
	if AM57xx_TIMER16 = y
		config AM57xx_TIMER16_PWM
			bool "PWM Support"
			depends on AM57xx_TIMER_PWM
			default n
		config AM57xx_TIMER16_CAPTURE
			bool "Capture Support"
			depends on AM57xx_TIMER_CAPTURE
			default n
		choice
			prompt "PWM / Capture Pin"
			depends on AM57xx_TIMER16_PWM || AM57xx_TIMER16_CAPTURE
			config AM57xx_TIMER16_XREF_CLK3
				bool "XREF_CLK3"
				depends on AM57xx_TIMER16_PWM || AM57xx_TIMER16_CAPTURE
			config AM57xx_TIMER16_VIN1A_DE0
				bool "VIN1A_DE0"
				depends on AM57xx_TIMER16_PWM || AM57xx_TIMER16_CAPTURE
		endchoice
	endif
endif
```

## avr/Kconfig
```kconfig
comment "Microchip AVR Settings"
choice 
	prompt "Select Processor Type"
	config ATMEGA328PB
		bool "Microchip ATmega328PB"
		depends on ARCH_AVR
	config AT90CAN128
		bool "Microchip AT90CAN128"
		depends on ARCH_AVR
endchoice
if ATMEGA328PB=y
	config MACH_AFLAGS
		string
		default "-mmcu=atmega328pb"
	config MACH_CFLAGS
		string
		default "-mmcu=atmega328pb"
	config MACH_LDFLAGS
		string
		default "-mmcu=atmega328pb"
	config MACH_GPIO_HAS_PORTB
		bool
		default y
	config MACH_GPIO_HAS_PORTC
		bool
		default y
	config MACH_GPIO_HAS_PORTD
		bool
		default y
	config MACH_GPIO_HAS_PORTE
		bool
		default y
endif
if AT90CAN128=y
	config MACH_AFLAGS
		string
		default "-mmcu=at90can128"
	config MACH_CFLAGS
		string
		default "-mmcu=at90can128"
	config MACH_LDFLAGS
		string
		default "-mmcu=at90can128"
	config MACH_GPIO_HAS_PORTA
		bool
		default y
	config MACH_GPIO_HAS_PORTB
		bool
		default y
	config MACH_GPIO_HAS_PORTC
		bool
		default y
	config MACH_GPIO_HAS_PORTD
		bool
		default y
	config MACH_GPIO_HAS_PORTE
		bool
		default y
	config MACH_GPIO_HAS_PORTF
		bool
		default y
	config MACH_GPIO_HAS_PORTG
		bool
		default y
endif
config MAX_SYSCALL_INTERRUPT_PRIORITY
	hex
	default 0x20
config KERNEL_INTERRUPT_PRIORITY 
	hex
	default 0xf0
config MACH_INIT_STACK_SIZE
	int "Init Stack Size"
	default 600
	help
		Stack Size of Init Prozess. Stack size used by Interrupt and Init Prozess
config MACH_INCLUDE
	string
	default "-Imach/avr/include"
config MACH_DEFINE_HEAP
	bool
	default y
config MACH_USE_GENERIC_FAULT_HANDLER
	bool
	default y
config MACH_HAS_NEWLIB
	bool
	default y
config MACH_HAS_GPIO
	bool
	default y
config MACH_HAS_TIMER
	bool
	default y
config MACH_HAS_PWM
	bool
	default y
config MACH_HAS_CAPTURE
	bool
	default n
config MACH_HAS_ADC
	bool
	default y
config MACH_HAS_UART
	bool
	default y
config MACH_HAS_NET
	bool
	default n
config MACH_AVR_DISABLE_WDOG
	bool "Disable Watchdog at startup"
	default y
config MACH_AVR_GPIO
	bool
	default y
	select GPIO
menuconfig MACH_AVR_UART
	bool "UART"
	depends on UART
	default y
menuconfig MACH_AVR_ADC
	bool "ADC"
	depends on ADC
	default n
menuconfig MACH_AVR_TIMER
	depends on TIMER
	bool "Timer"
	default n
```

## c28x/Kconfig
```kconfig
comment "C28X Settings"
config MACH_INIT_STACK_SIZE
	int "Init Stack Size"
	default 600
	help
		Stack Size of Init Prozess. Stack size used by Interrupt and Init Prozess
config MACH_HEAP_SIZE
	int "Init Heap Size"
	default 100
#config MACH_LD_SCRIPT
#	string 
#	default "mach/s32k/s32k.lds"
config MACH_INCLUDE
	string
	default "-Imach/c28x/include"
config MACH_DEFINE_HEAP
	bool
	default y
config EXTRA_MACH_LINKFLAGS
	string
	default "-z -i$(shell dirname $(shell which $(CC)))/../lib --disable_auto_rts --priority --reread_libs --diag_suppress=16002 --diag_suppress=10063-D --xml_link_info='projekt_linkInfo.xml' --entry_point=code_start --rom_model --warn_sections --stack_size=$(CONFIG_MACH_INIT_STACK_SIZE) -heap=$(CONFIG_MACH_HEAP_SIZE)"
config MACH_LIBS
	string
	default "-lrts2800_ml.lib mach/c28x/F28069F.cmd"
config MACH_HAS_UART
	bool
	default y
config MACH_HAS_GPIO
	bool
	default y
config MACH_HAS_CAN
	bool
	default y
config MACH_HAS_TIMER
	bool
	default y
	select TIMER
	select MACH_C28X_CPU_TIMER
	select MACH_C28X_CPU_TIMER2
	help
		Timer is needed by this port!
menu "Clock Configuation"
	choice 
		prompt "Low Speed Pre Scaler"
		config MACH_C28X_CLOCK_LOPCP_BY_4
			bool "/4"
		config MACH_C28X_CLOCK_LOPCP_BY_1
			bool "/1"
		config MACH_C28X_CLOCK_LOPCP_BY_2
			bool "/2"
	endchoice
	config MACH_C28X_OSCILLATOR_SPEED
		int "Quartz Oscillator Speed"
		default 20000000
	comment "Waring Invalid Setting!"
	depends on MACH_C28X_PLL_MULL > 18
	config MACH_C28X_PLL_MULL
		int "PLL Multiplier"
		default 18
	choice 
		prompt "PLL Div"
		config MACH_C28X_PLL_DIV_BY_1
			bool "/1"
		config MACH_C28X_PLL_DIV_BY_2
			bool "/3"
		config MACH_C28X_PLL_DIV_BY_4
			bool "/4"
	endchoice
endmenu
menu "GPIO Subsystem"
	config MACH_C28x_GPIO
		bool
		select GPIO
		default y
	config MACH_C28X_GPIO_PINS
		int "Count of GPIO Pins"
		default 2
endmenu
choice 
	prompt "DMA RAM Setup"
	config MACH_C28X_RAM_DMA_OFF
		bool "0 DMA Sections (43Kb for Application)"
	config MACH_C28X_RAM_DMA_4
		bool "4 DMA Section RAML5-8 (5kb for Application)"
	config MACH_C28X_RAM_DMA_1
		bool "1 DMA Section RAM8 only (37kb for Application)"
endchoice
menuconfig MACH_C28X_SCI
	bool "SCI Driver"
	depends on UART
	default y
	if MACH_C28X_SCI = y
		source mach/c28x/Kconfig.sci
	endif
menuconfig MACH_C28X_CPU_TIMER
	bool "Timer"
	depends on TIMER
	default y
	if MACH_C28X_CPU_TIMER
		source mach/c28x/Kconfig.timer
	endif
menuconfig MACH_C28X_CAN
	bool "CAN Driver"
	depends on CAN
	default y
	if MACH_C28X_CAN = y
		source mach/c28x/Kconfig.can
	endif
```
