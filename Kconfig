## Kconfig
```kconfig
menu "Mach Settings"
choice 
	prompt "Select Mach"
	config MACH_VF610
		bool "VF610-M4"
		depends on ARCH_ARM
		depends on ARCH_ARM_CORTEX_M4F || ARCH_ARM_CORTEX_M3
		help 
			vF610 M4 Mach
	config MACH_LINUX
		bool "Linux Emulator"
		depends on ARCH_X86
		depends on ARCH_X86_LINUX
		select INCLUDE_xTaskGetCurrentTaskHandle
	config MACH_STM32
		bool "ST STM32"
		depends on ARCH_ARM
		depends on ARCH_ARM_CORTEX_M0 || ARCH_ARM_CORTEX_M4F || ARCH_ARM_CORTEX_M3
		help
			ST STM32 Prozessor
	config MACH_IMX6
		bool "NXP Imx6sx"
		depends on ARCH_ARM
		depends on ARCH_ARM_CORTEX_M4F || ARCH_ARM_CORTEX_M3
		help
			imx6x M4 Mach
	config MACH_AM57xx
		bool "TI AM57xx"
		depends on ARCH_ARM
		depends on ARCH_ARM_CORTEX_M3
		help
			am57xx M4 Mach
	config MACH_S32K
		bool "NXP S32K"
		depends on ARCH_ARM
		depends on ARCH_ARM_CORTEX_M0 || ARCH_ARM_CORTEX_M3 ||  ARCH_ARM_CORTEX_M4F
		help
			NXP S32K Mach
	config MACH_C28X
		bool "C28x"
		depends on ARCH_C2000
		depends on ARCH_C2000_C28x
		help
			TI C2000 DSP
endchoice
if MACH_VF610=y
source mach/vf610/Kconfig
endif
if MACH_LINUX=y
source mach/linux/Kconfig
endif
if MACH_STM32=y
source mach/stm32/Kconfig
endif
if MACH_IMX6=y
source mach/imx6/Kconfig
endif
if MACH_AM57xx
source mach/am57xx/Kconfig
endif
if MACH_S32K=y
source mach/s32k/Kconfig
endif
if MACH_VF610=y || MACH_S32K=y
source mach/nxp/Kconfig
endif
if MACH_AM57xx=y
source mach/ti/Kconfig
endif
if MACH_C28X=y
source mach/c28x/Kconfig
endif
endmenu
```

## am57xx/Kconfig
```kconfig
comment "AM57xx Settings"
config MAX_SYSCALL_INTERRUPT_PRIORITY
	hex
	default 0x20
config KERNEL_INTERRUPT_PRIORITY
	hex
	default 0xf0

config MACH_INIT_STACK_SIZE
	int "Init Stack Size"
	default 600
	help
		Stack Size of Init Prozess. Stack size used by Interrupt and Init Prozess

config MACH_LD_SCRIPT
	string
	default "mach/am57xx/am57xx.lds"

config MACH_INCLUDE
	string
	default "-Imach/am57xx/include"
config MACH_DEFINE_HEAP
	bool
	default y
config MACH_USE_GENERIC_FAULT_HANDLER
	bool
	default y
config MACH_HAS_NEWLIB
	bool
	default y
config MACH_HAS_NVIC
	bool
	default y
config MACH_HAS_MAILBOX
	bool
	default y
config MACH_HAS_GPIO
	bool
	default y
config MACH_HAS_SPI
	bool
	default y
config MACH_HAS_TIMER
	bool
	default y
config MACH_HAS_PWM
	bool
	default y
config MACH_HAS_CAPTURE
	bool
	default y
config AM57xx_WAIT_FOR_DEBUGGER
	bool "Wait for Debugger"
	default n
config AM57xx_MUX_DEBUG
	bool "Mux Debug"
	default n
config AM57xx_GPIO
	bool "AM57xx GPIO Contoller"
	default n
	depends on GPIO
	config AM57xx_GPIO_DEBUG
		bool "Debug GPIO"
		default n
		depends on AM57xx_GPIO
menuconfig AM57xx_MAILBOX
	depends on MAILBOX
	bool "AM57xx Mailbox"
	default n
	source mach/am57xx/Kconfig.mailbox
menuconfig AM57xx_SPI
	depends on SPI
	bool "AM57xx SPI"
	default n
	source mach/am57xx/Kconfig.spi
menuconfig AM57xx_TIMER
	depends on TIMER
	bool "Am57xx General-Purpose Timers"
	default n
	source mach/am57xx/Kconfig.timer
menuconfig AM57xx_PWMSS_TIMER
	depends on TIMER
	bool "AM57xx PWMSS Timer"
	default n
	source mach/am57xx/Kconfig.pwmss
```

## am57xx/Kconfig.can
```kconfig
comment "Warning: Silent mode disables physical connection of CAN_TX to the CAN Bus"
    depends on TI_DCAN_SILENT_MODE
config TI_DCAN_SILENT_MODE
    bool "Activate Silent Mode"
    default n
    help
        Activate Silent mode
        All sent messages are also received
        No dominant Bits are sent on the real bus!
        The DCAN is still able to receive valid data from the real bus
        Silent mode and loopback mode can be activated together

choice
    prompt "loopback mode"
    optional

comment "Waring: Loopback Mode disables physical connection of CAN_RX to the CAN Bus!"
	depends on TI_DCAN_LOOP_BACK_MODE
config TI_DCAN_LOOP_BACK_MODE
	bool "Activate Loopback Mode (Debug Mode)"
	help
        Activate Loopback Debug Mode
        All sent messages are also received
        The CAN_RX is disconnected in this mode!
        The DCAN is still able to send dominant bits to the real bus
        Loopback mode and silent mode can be activated together

comment "Waring: Loopback Mode disables physical connection of CAN_RX to the CAN Bus!"
	depends on TI_DCAN_EXTERNAL_LOOP_BACK_MODE
config TI_DCAN_EXTERNAL_LOOP_BACK_MODE
	bool "Activate external Loopback Mode (Debug Mode)"
	help
        Activate external Loopback Debug Mode
        All sent messages are also received
        CAN_TX pin is connected to the Rx and Tx of the CAN Core
        The CAN_RX is disconnected in this mode!

endchoice


menuconfig MACH_AM57xx_DCAN_CAN1
    bool "CAN 1"
    default n
if MACH_AM57xx_DCAN_CAN1=y
    comment "Waring: More than 63 Filter are not posible"
        depends on MACH_AM57xx_DCAN_CAN1_MAX_FILTER >127
    config MACH_AM57xx_DCAN_CAN1_MAX_FILTER
        int "Max Input Filters"
        default 2
    config MACH_AM57xx_DCAN_CAN1_FILTER_QUEUE_ENTRIES
        int "Max Filter Software Queue Entries"
        default 2
        help
            The Hardware has only one entrie per filter
            so we need a software queue to store the messages
 
            How many CAN Frames can be stored in this software queue?
endif


menuconfig MACH_AM57xx_DCAN_CAN2
    bool "CAN 2"
    default n
if MACH_AM57xx_DCAN_CAN2=y
    comment "Waring: More than 63 Filter are not posible"
        depends on MACH_AM57xx_DCAN_CAN2_MAX_FILTER >127
    config MACH_AM57xx_DCAN_CAN2_MAX_FILTER
        int "Max Input Filters"
        default 2
    config MACH_AM57xx_DCAN_CAN2_FILTER_QUEUE_ENTRIES
        int "Max Filter Software Queue Entries"
        default 2
        help
            The Hardware has only one entrie per filter
            so we need a software queue to store the messages
 
            How many CAN Frames can be stored in this software queue?
endif
```
