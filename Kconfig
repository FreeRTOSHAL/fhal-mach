## m0/Kconfig
```kconfig
comment "M0 DesignStart Settings"
config MACH_LD_SCRIPT
	string 
	default "mach/m0/m0.lds"
config MACH_INCLUDE
	string
	default "-Imach/m0/include"
config MACH_DEFINE_HEAP
	bool
	default y
config MACH_INIT_STACK_SIZE
	int "Init Stack Size"
	default 600
	help
		Stack Size of Init Prozess. Stack size used by Interrupt and Init Prozess
config MACH_HAS_UART
	bool
	default y
config MACH_HAS_GPIO
	bool
	default y
config MACH_HAS_NEWLIB
	bool
	default y
#config MACH_HAS_SPI
#	bool
#	default y
#config MACH_HAS_ADC
#	bool
#	default y
# VF610 has NVIC but Interrupt Router must set befor NVIC
config MACH_HAS_NVIC
	bool
	default y
```

## nxp/Kconfig
```kconfig
config NXP_FLEXTIMER
	bool
	default n
	config NXP_FLEXTIMER_ERRATA_E6484
		bool 
		default n
	config NXP_FLEXTIMER_VERSION_1
		bool
		default n
		help
			Version used by Vybird VF610
	config NXP_FLEXTIMER_VERSION_2
		bool
		default n
		help
			Version used by S32K
	config NXP_FLEXTIMER_PWM
		bool
		default n
	config NXP_FLEXTIMER_CAPTURE
		bool
		default n
config NXP_GPIO
	bool
	default n
config NXP_GPIO_MUX
	bool
	default n
config NXP_FLEXCAN
	bool
	default n
```

## polarfire/Kconfig
```kconfig
comment "Micochip PolarFire Settings"
config MACH_LD_SCRIPT
	string 
	default "mach/polarfire/riscv.lds"
config MACH_INCLUDE
	string
	default "-Imach/polarfire/include"
config MACH_HAS_MTIME
	bool
	default y
config MACH_DEFINE_HEAP
	bool
	default y
config MACH_INIT_STACK_SIZE
	int "Init Stack Size"
	default 600
config MACH_NEED_RISCV_INIT
	bool
	default y
config MACH_NEED_RISCV_HARDWARE_FLOAD
	bool
	default y
config MACH_HAS_PLIC
	bool
	default y
config MACH_IRQ_COUNT
	int 
	default 185
config MACH_IRQ_MAX_PRIO
	int 
	default 7
config MACH_HAS_NEWLIB
	bool
	default y
config MACH_HAS_UART
	bool
	default y
#config MACH_HAS_TIMER
#	bool
#	default y
config MACH_NEED_GENERIC_SYSINIT
	bool
	default y
config MACH_RISCV_64BIT
	select ARCH_64BIT
	bool 
	default y

config MACH_CFLAGS
	string
	default "-march=rv64imafd -mabi=lp64d"
config MACH_AFLAGS
	string
	default "-march=rv64imafd -mabi=lp64d"
	# RV64ACDFIM
```

## riscv-qemu/Kconfig
```kconfig
comment "QEMU RISC-V Settings"
config MACH_LD_SCRIPT
	string 
	default "mach/riscv-qemu/riscv.lds"
config MACH_INCLUDE
	string
	default "-Imach/riscv-qemu/include"
config MACH_HAS_MTIME
	bool
	default y
config MACH_DEFINE_HEAP
	bool
	default y
config MACH_MTIME_BASE_ADDRESS
	int
	default 33603576 # 0x0200bff8
config MACH_MTIMECMP_BASE_ADDRESS
	int
	default 33570816 # 0x02004000
config MACH_INIT_STACK_SIZE
	int "Init Stack Size"
	default 600
config MACH_NEED_RISCV_INIT
	bool
	default y
config MACH_HAS_PLIC
	bool
	default y
config MACH_IRQ_COUNT
	int 
	default 127
config MACH_IRQ_MAX_PRIO
	int 
	default 7
config MACH_HAS_NEWLIB
	bool
	default y
config MACH_HAS_UART
	bool
	default y
config MACH_HAS_TIMER
	bool
	default y
config MACH_NEED_GENERIC_SYSINIT
	bool
	default y
config MACH_NEED_RISCV_HARDWARE_FLOAD
	bool
	default y
config MACH_NS16550
	bool "NS16550 UART"
	select USE_TASK_NOTIFICATIONS
	depends on UART
if MACH_NS16550=y
	config MACH_NS16550_UART0
		bool "UART 0"
		default n
endif

config MACH_RISCV_64BIT
	select ARCH_64BIT
	bool "64-Bit"

if MACH_RISCV_64BIT=y
	config MACH_CFLAGS
		string
		default "-march=rv64imafd -mabi=lp64d"
	config MACH_AFLAGS
		string
		default "-march=rv64imafd -mabi=lp64d"
		# rv64imafdcsu
endif
if MACH_RISCV_64BIT=n
	config MACH_CFLAGS
		string
		default "-march=rv32imafd -mabi=ilp32d"
	config MACH_AFLAGS
		string
		default "-march=rv32imafd -mabi=ilp32d"
		# rv32imafdcsu
endif


config MACH_GOLDFLISH_RTC
	bool "Goldflish RTC Timer"
	depends on TIMER
	default n
if MACH_GOLDFLISH_RTC=y
	config MACH_GOLDFLISH_RTC_TIMER0 
		bool "Goldflish RTC Timer 0"
		default n
endif
```
