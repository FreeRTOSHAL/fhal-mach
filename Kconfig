## c28x/Kconfig.can
```kconfig
config MACH_C28X_ECAN0
	bool "eCAN0"
	select USE_TASK_NOTIFICATIONS
if MACH_C28X_ECAN0=y
	choice
		prompt "RX Pin"
		config MACH_C28X_ECAN0_GPIO_30
			bool "GPIO_30"
	endchoice
	choice
		prompt "TX Pin"
		config MACH_C28X_ECAN0_GPIO_31
			bool "GPIO_31"
	endchoice
	config MACH_C28X_ECAN_CAN0_FILTER_QUEUE_ENTRIES
		int "Max Filter Software Queue Entries"
		default 2
		help
			The hardware has only one entry per filter,
			so we need a software queue to store the messages

			How many CAN frames can be stored in this software queue?
endif
```
