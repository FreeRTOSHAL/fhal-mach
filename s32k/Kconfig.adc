## vf610/Kconfig
```kconfig
comment "VF610 Settings"
config MAX_SYSCALL_INTERRUPT_PRIORITY
	hex
	default 0x20
config KERNEL_INTERRUPT_PRIORITY 
	hex
	default 0xf0
comment "WARNING: Load Address is 0x3F000000"
	depends on VF610_LOCATION_SRAM
comment "WARNING: ELF Loader is needed!"
	depends on VF610_LOCATION_BOTH
choice
	prompt "Memmory Location"
	config VF610_LOCATION_SRAM
		bool "SRAM"
		help
			FreeRTOS + Application in SRAM(max 256K)
	config VF610_LOCATION_TCM
		bool "TCM"
		help
			FreeRTOS + Application in TCM(max 32K)
	config VF610_LOCATION_BOTH
		bool "TCM + SRAM"
		help
			FreeRTOS Located in fast TCM and Apllication located at SRAM(max 256K + 32K)

			WARNING Start out of A5 without Elf Loader imposible!
endchoice

config MACH_INIT_STACK_SIZE
	int "Init Stack Size"
	default 600
	help
		Stack Size of Init Prozess. Stack size used by Interrupt and Init Prozess

config MACH_LD_SCRIPT
	string 
	default "mach/vf610/vf610.lds"

config MACH_INCLUDE
	string
	default "-Imach/vf610/include -Imach/nxp/include/"
config MACH_USE_GENERIC_FAULT_HANDLER
	bool
	default y
config USE_NXP_LIB
	bool
	default y
config VF610_UART
	bool "VF610 UART"
	depends on UART
	default y
	select UART_GENERIC_STRING
	select UART_GENERIC_BYTE
menuconfig VF610_LPUART
	bool "LPUart Driver"
	depends on VF610_UART
	default y
config VF610_LPUART00
	bool "LPUART Device 0"
	depends on VF610_LPUART
	default y
config VF610_LPUART01
	bool "LPUART Device 1"
	depends on VF610_LPUART
	default y
config VF610_LPUART02
	bool "LPUART Device 2"
	depends on VF610_LPUART
	default y
config VF610_LPUART03
	bool "LPUART Device 3"
	depends on VF610_LPUART
	default y
config VF610_LPUART04
	bool "LPUART Device 4"
	depends on VF610_LPUART
	default y
config VF610_LPUART05
	bool "LPUART Device 5"
	depends on VF610_LPUART
	default y
config BUFFER_UART
	bool "Buffer UART Driver"
	default n
	depends on VF610_UART
	depends on BUFFER
	depends on VF610_BUFFER
	select VF610_BUFFER_1
	config BUFFER_UART_WAIT_TO_TX
		bool "Wait for Linux Kernel UART Buffer"
		depends on BUFFER_UART
		default n
		help
			Wait for linux Kernel
		config BUFFER_UART_MAX_TRYS
			depends on BUFFER_UART
			depends on BUFFER_UART_WAIT_TO_TX
			int "Max Try to send a Char to Linux Kernel"
			default 50
			help
				Max Trys to send a Char to Linux Kernel

menuconfig VF610_BUFFER
	bool "Buffer Driver"
	depends on BUFFER
	default n
	config VF610_BUFFER_0
		bool "Buffer on INT 0"
		depends on VF610_BUFFER
		default n
	config VF610_BUFFER_1
		bool "Buffer on INT 1"
		depends on VF610_BUFFER
		default n
	config VF610_BUFFER_2
		bool "Buffer on INT 2"
		depends on VF610_BUFFER
		default n
	config VF610_BUFFER_3
		bool "Buffer on INT 3"
		depends on VF610_BUFFER
		default n
config MACH_DEFINE_HEAP
	bool
	default y
config MACH_HAS_UART
	bool
	default y
config MACH_HAS_GPIO
	bool
	default y
config MACH_HAS_NEWLIB
	bool
	default y
config MACH_HAS_BUFFER
	bool
	default y
config MACH_HAS_SPI
	bool
	default y
config MACH_HAS_ADC
	bool
	default y
config MACH_HAS_TIMER
	bool
	default y
config MACH_HAS_PWM
	bool
	default y
config MACH_HAS_CAPTURE
	bool
	default y
# VF610 has NVIC but Interrupt Router must set befor NVIC
#config MACH_HAS_NVIC
#	bool
#	default y
config VF610_CACHE
	bool "Activate VF610 M4 Cache"
	default n
	select CACHE
config VF610_GPIO
	bool "Activate GPIO"
	depends on GPIO
	select NXP_GPIO
	config GPIO_PORT_COUNT
		int
		depends on NXP_GPIO
		default 5
menuconfig MACH_VF610_FLEXTIMER
	depends on TIMER
	select NXP_FLEXTIMER
	select NXP_FLEXTIMER_ERRATA_E6484
	select NXP_FLEXTIMER_VERSION_1
	bool "Activate Flextimer"
	default n
	config MACH_VF610_FLEXTIMER_0
		depends on MACH_VF610_FLEXTIMER
		bool "Activate Flextimer 0"
		default n
	config MACH_VF610_FLEXTIMER_1
		depends on MACH_VF610_FLEXTIMER
		bool "Activate Flextimer 1"
		default n
	config MACH_VF610_FLEXTIMER_2
		depends on MACH_VF610_FLEXTIMER
		bool "Activate Flextimer 2"
		default n
	config MACH_VF610_FLEXTIMER_3
		depends on MACH_VF610_FLEXTIMER
		bool "Activate Flextimer 3"
		default n
	menuconfig MACH_VF610_FLEXTIMER_PWM
		depends on MACH_VF610_FLEXTIMER && PWM
		select MACH_NXP_FLEXTIMER_PWM
		bool "Activate Flextimer PWM "
		default n
		config MACH_VF610_FLEXTIMER_PWM_0_0
			depends on MACH_VF610_FLEXTIMER_PWM && MACH_VF610_FLEXTIMER_0
			bool "PWM on PTB0"
			default n
		config MACH_VF610_FLEXTIMER_PWM_0_1
			depends on MACH_VF610_FLEXTIMER_PWM && MACH_VF610_FLEXTIMER_0
			bool "PWM on PTB1"
			default n
		config MACH_VF610_FLEXTIMER_PWM_0_2
			depends on MACH_VF610_FLEXTIMER_PWM && MACH_VF610_FLEXTIMER_0
			bool "PWM on PTB2"
			default n
		config MACH_VF610_FLEXTIMER_PWM_0_3
			depends on MACH_VF610_FLEXTIMER_PWM && MACH_VF610_FLEXTIMER_0
			bool "PWM on PTB3"
			default n
		config MACH_VF610_FLEXTIMER_PWM_0_4
			depends on MACH_VF610_FLEXTIMER_PWM && MACH_VF610_FLEXTIMER_0
			bool "PWM on PTB4"
			default n
		config MACH_VF610_FLEXTIMER_PWM_0_5
			depends on MACH_VF610_FLEXTIMER_PWM && MACH_VF610_FLEXTIMER_0
			bool "PWM on PTB5"
			default n
		config MACH_VF610_FLEXTIMER_PWM_0_6
			depends on MACH_VF610_FLEXTIMER_PWM && MACH_VF610_FLEXTIMER_0
			bool "PWM on PTB6"
			default n
		config MACH_VF610_FLEXTIMER_PWM_0_7
			depends on MACH_VF610_FLEXTIMER_PWM && MACH_VF610_FLEXTIMER_0
			bool "PWM on PTB7"
			default n
		config MACH_VF610_FLEXTIMER_PWM_1_0
			depends on MACH_VF610_FLEXTIMER_PWM && MACH_VF610_FLEXTIMER_1
			bool "PWM on PTB8"
			default n
		config MACH_VF610_FLEXTIMER_PWM_1_1
			depends on MACH_VF610_FLEXTIMER_PWM && MACH_VF610_FLEXTIMER_1
			bool "PWM on PTB9"
			default n
		config MACH_VF610_FLEXTIMER_PWM_2_0
			depends on MACH_VF610_FLEXTIMER_PWM && MACH_VF610_FLEXTIMER_2
			bool "PWM on PTD23"
			default n
		config MACH_VF610_FLEXTIMER_PWM_2_1
			depends on MACH_VF610_FLEXTIMER_PWM && MACH_VF610_FLEXTIMER_2
			bool "PWM on PTD22"
			default n
		config MACH_VF610_FLEXTIMER_PWM_3_0
			depends on MACH_VF610_FLEXTIMER_PWM && MACH_VF610_FLEXTIMER_3
			bool "PWM on PTD22"
			default n
		config MACH_VF610_FLEXTIMER_PWM_3_1
			depends on MACH_VF610_FLEXTIMER_PWM && MACH_VF610_FLEXTIMER_3
			bool "PWM on PTD31"
			default n
		config MACH_VF610_FLEXTIMER_PWM_3_2
			depends on MACH_VF610_FLEXTIMER_PWM && MACH_VF610_FLEXTIMER_3
			bool "PWM on PTD30"
			default n
		config MACH_VF610_FLEXTIMER_PWM_3_3
			depends on MACH_VF610_FLEXTIMER_PWM && MACH_VF610_FLEXTIMER_3
			bool "PWM on PTD29"
			default n
		config MACH_VF610_FLEXTIMER_PWM_3_4
			depends on MACH_VF610_FLEXTIMER_PWM && MACH_VF610_FLEXTIMER_3
			bool "PWM on PTD28"
			default n
		config MACH_VF610_FLEXTIMER_PWM_3_5
			depends on MACH_VF610_FLEXTIMER_PWM && MACH_VF610_FLEXTIMER_3
			bool "PWM on PTD26"
			default n
		config MACH_VF610_FLEXTIMER_PWM_3_6
			depends on MACH_VF610_FLEXTIMER_PWM && MACH_VF610_FLEXTIMER_3
			bool "PWM on PTD25"
			default n
		config MACH_VF610_FLEXTIMER_PWM_3_7
			depends on MACH_VF610_FLEXTIMER_PWM && MACH_VF610_FLEXTIMER_3
			bool "PWM on PTD24"
			default n
	menuconfig MACH_VF610_FLEXTIMER_CAPTURE
		depends on MACH_VF610_FLEXTIMER && CAPTURE
		bool "Activate Flextimer CAPTURE "
		default n
		config MACH_VF610_FLEXTIMER_CAPTURE_0_0
			depends on MACH_VF610_FLEXTIMER_CAPTURE && MACH_VF610_FLEXTIMER_0
			bool "CAPTURE on PTB0"
			default n
		config MACH_VF610_FLEXTIMER_CAPTURE_0_1
			depends on MACH_VF610_FLEXTIMER_CAPTURE && MACH_VF610_FLEXTIMER_0
			bool "CAPTURE on PTB1"
			default n
		config MACH_VF610_FLEXTIMER_CAPTURE_0_2
			depends on MACH_VF610_FLEXTIMER_CAPTURE && MACH_VF610_FLEXTIMER_0
			bool "CAPTURE on PTB2"
			default n
		config MACH_VF610_FLEXTIMER_CAPTURE_0_3
			depends on MACH_VF610_FLEXTIMER_CAPTURE && MACH_VF610_FLEXTIMER_0
			bool "CAPTURE on PTB3"
			default n
		config MACH_VF610_FLEXTIMER_CAPTURE_0_4
			depends on MACH_VF610_FLEXTIMER_CAPTURE && MACH_VF610_FLEXTIMER_0
			bool "CAPTURE on PTB4"
			default n
		config MACH_VF610_FLEXTIMER_CAPTURE_0_5
			depends on MACH_VF610_FLEXTIMER_CAPTURE && MACH_VF610_FLEXTIMER_0
			bool "CAPTURE on PTB5"
			default n
		config MACH_VF610_FLEXTIMER_CAPTURE_0_6
			depends on MACH_VF610_FLEXTIMER_CAPTURE && MACH_VF610_FLEXTIMER_0
			bool "CAPTURE on PTB6"
			default n
		config MACH_VF610_FLEXTIMER_CAPTURE_0_7
			depends on MACH_VF610_FLEXTIMER_CAPTURE && MACH_VF610_FLEXTIMER_0
			bool "CAPTURE on PTB7"
			default n
		config MACH_VF610_FLEXTIMER_CAPTURE_1_0
			depends on MACH_VF610_FLEXTIMER_CAPTURE && MACH_VF610_FLEXTIMER_1
			bool "CAPTURE on PTB8"
			default n
		config MACH_VF610_FLEXTIMER_CAPTURE_1_1
			depends on MACH_VF610_FLEXTIMER_CAPTURE && MACH_VF610_FLEXTIMER_1
			bool "CAPTURE on PTB9"
			default n
		config MACH_VF610_FLEXTIMER_CAPTURE_2_0
			depends on MACH_VF610_FLEXTIMER_CAPTURE && MACH_VF610_FLEXTIMER_2
			bool "CAPTURE on PTD23"
			default n
		config MACH_VF610_FLEXTIMER_CAPTURE_2_1
			depends on MACH_VF610_FLEXTIMER_CAPTURE && MACH_VF610_FLEXTIMER_2
			bool "CAPTURE on PTD22"
			default n
		config MACH_VF610_FLEXTIMER_CAPTURE_3_0
			depends on MACH_VF610_FLEXTIMER_CAPTURE && MACH_VF610_FLEXTIMER_3
			bool "CAPTURE on PTD22"
			default n
		config MACH_VF610_FLEXTIMER_CAPTURE_3_1
			depends on MACH_VF610_FLEXTIMER_CAPTURE && MACH_VF610_FLEXTIMER_3
			bool "CAPTURE on PTD31"
			default n
		config MACH_VF610_FLEXTIMER_CAPTURE_3_2
			depends on MACH_VF610_FLEXTIMER_CAPTURE && MACH_VF610_FLEXTIMER_3
			bool "CAPTURE on PTD30"
			default n
		config MACH_VF610_FLEXTIMER_CAPTURE_3_3
			depends on MACH_VF610_FLEXTIMER_CAPTURE && MACH_VF610_FLEXTIMER_3
			bool "CAPTURE on PTD29"
			default n
		config MACH_VF610_FLEXTIMER_CAPTURE_3_4
			depends on MACH_VF610_FLEXTIMER_CAPTURE && MACH_VF610_FLEXTIMER_3
			bool "CAPTURE on PTD28"
			default n
		config MACH_VF610_FLEXTIMER_CAPTURE_3_5
			depends on MACH_VF610_FLEXTIMER_CAPTURE && MACH_VF610_FLEXTIMER_3
			bool "CAPTURE on PTD26"
			default n
		config MACH_VF610_FLEXTIMER_CAPTURE_3_6
			depends on MACH_VF610_FLEXTIMER_CAPTURE && MACH_VF610_FLEXTIMER_3
			bool "CAPTURE on PTD25"
			default n
		config MACH_VF610_FLEXTIMER_CAPTURE_3_7
			depends on MACH_VF610_FLEXTIMER_CAPTURE && MACH_VF610_FLEXTIMER_3
			bool "CAPTURE on PTD24"
			default n

menuconfig DSPI
	depends on SPI
	bool "Activate DSPI"
	config SPIDEBUG
		bool "SPI Debug Mode"
		depends on DSPI
		default n
	config DSPI_0
		bool "Activate DSPI 0"
		depends on DSPI
		default n
	menuconfig DSPI_1
		bool "Activate DSPI 1"
		depends on DSPI
		default n
		choice
			prompt "SCLK"
			depends on DSPI_1
			config DSPI_1_PTD8
				bool "SCLK on PTD8"
				depends on DSPI_1
			config DSPI_1_PTC8
				bool "SCLK on PTC8"
				depends on DSPI_1
		endchoice
		choice
			prompt "MOSI"
			depends on DSPI_1
			config DSPI_1_PTD7
				bool "MOSI on PTD7"
				depends on DSPI_1
			config DSPI_1_PTC7
				bool "MOSI on PTC7"
				depends on DSPI_1
		endchoice
		choice
			prompt "MISO"
			depends on DSPI_1
			config DSPI_1_PTD6
				bool "MISO on PTD6"
				depends on DSPI_1
			config DSPI_1_PTC6
				bool "MISO on PTC6"
				depends on DSPI_1
		endchoice
		choice
			prompt "CS0"
			depends on DSPI_1
			config DSPI_1_NO_CS0
				bool "No CS0"
				depends on DSPI_1
			config DSPI_1_PTD5
				bool "CS0 on PTD5"
				depends on DSPI_1
			config DSPI_1_PTC5
				bool "CS0 on PTC5"
				depends on DSPI_1
		endchoice
		choice
			prompt "CS1"
			depends on DSPI_1
			config DSPI_1_NO_CS1
				bool "No CS1"
				depends on DSPI_1
			config DSPI_1_PTD4
				bool "CS1 on PTD4"
				depends on DSPI_1
			config DSPI_1_PTC4
				bool "CS1 on PTC4"
				depends on DSPI_1
		endchoice
		choice
			prompt "CS2"
			depends on DSPI_1
			config DSPI_1_NO_CS2
				bool "No CS2"
				depends on DSPI_1
			config DSPI_1_PTD3
				bool "CS2 on PTD3"
				depends on DSPI_1
			config DSPI_1_PTC30
				bool "CS2 on PTC30"
				depends on DSPI_1
		endchoice
		choice
			prompt "CS3"
			depends on DSPI_1
			config DSPI_1_NO_CS3
				bool "No CS3"
				depends on DSPI_1
			config DSPI_1_PTD2
				bool "CS3 on PTD2"
				depends on DSPI_1
			config DSPI_1_PTE12
				bool "CS3 on PTE12"
				depends on DSPI_1
		endchoice
	config DSPI_2
		bool "Activate DSPI 2"
		depends on DSPI
		default n
	config DSPI_3
		bool "Activate DSPI 3"
		depends on DSPI
		default n
menuconfig VF610_ADC
	bool "Activate ADC Driver"
	depends on ADC
	default y
	menuconfig VF610_ADC_0
		bool "Activate ADC 0"
		depends on VF610_ADC
		default n
		config VF610_ADC_0_PTA18
			bool "Activate ADC on PTA18"
			depends on VF610_ADC_0
			default n
		config VF610_ADC_0_PTA19
			bool "Activate ADC on PTA19"
			depends on VF610_ADC_0
			default n
		config VF610_ADC_0_PTB0
			bool "Activate ADC on PTB0"
			depends on VF610_ADC_0
			default n
		config VF610_ADC_0_PTB1
			bool "Activate ADC on PTB1"
			depends on VF610_ADC_0
			default n
		config VF610_ADC_0_PTB4
			bool "Activate ADC on PTB4"
			depends on VF610_ADC_0
			default n
		config VF610_ADC_0_PTC30
			bool "Activate ADC on PTC30"
			depends on VF610_ADC_0
			default n
		config VF610_ADC_0_PTC14
			bool "Activate ADC on PTC14"
			depends on VF610_ADC_0
			default n
		config VF610_ADC_0_PTC15
			bool "Activate ADC on PTC15"
			depends on VF610_ADC_0
			default n
		config VF610_ADC_0_ADC0SE8
			bool "Activate ADC on ADC0SE8"
			depends on VF610_ADC_0
			default n
		config VF610_ADC_0_ADC0SE9
			bool "Activate ADC on ADC0SE9"
			depends on VF610_ADC_0
		config VF610_ADC_0_DAC0
			bool "Activate ADC on DAC0"
			depends on VF610_ADC_0
			default n
		config VF610_ADC_0_VSS33
			bool "Activate ADC on VSS33"
			depends on VF610_ADC_0
			default n
		config VF610_ADC_0_VREF
			bool "Activate ADC on VREF"
			depends on VF610_ADC_0
			default n
		config VF610_ADC_0_Temp
			bool "Activate Tempatur Sensor"
			depends on VF610_ADC_0
			default n
		config VF610_ADC_0_VREF_PMU
			bool "Activate ADC on VREF at PMU"
			depends on VF610_ADC_0
			default n
	menuconfig VF610_ADC_1
		bool "Activate ADC 1"
		depends on VF610_ADC
		default n
		config VF610_ADC_1_PTA16
			bool "Activate ADC on PTA16"
			depends on VF610_ADC_1
			default n
		config VF610_ADC_1_PTA17
			bool "Activate ADC on PTA17"
			depends on VF610_ADC_1
			default n
		config VF610_ADC_1_PTB2
			bool "Activate ADC on PTB2"
			depends on VF610_ADC_1
			default n
		config VF610_ADC_1_PTB3
			bool "Activate ADC on PTB3"
			depends on VF610_ADC_1
			default n
		config VF610_ADC_1_PTB5
			bool "Activate ADC on PTB5"
			depends on VF610_ADC_1
			default n
		config VF610_ADC_1_PTC31
			bool "Activate ADC on PTC31"
			depends on VF610_ADC_1
			default n
		config VF610_ADC_1_PTC16
			bool "Activate ADC on PTC16"
			depends on VF610_ADC_1
			default n
		config VF610_ADC_1_PTC17
			bool "Activate ADC on PTC17"
			depends on VF610_ADC_1
			default n
		config VF610_ADC_1_ADC1SE8
			bool "Activate ADC on ADC1SE8"
			depends on VF610_ADC_1
			default n
		config VF610_ADC_1_ADC1SE9
			bool "Activate ADC on ADC1SE9"
			depends on VF610_ADC_1
		config VF610_ADC_1_DAC1
			bool "Activate ADC on DAC1"
			depends on VF610_ADC_1
			default n
		config VF610_ADC_1_VSS33
			bool "Activate ADC on VSS33"
			depends on VF610_ADC_1
			default n
		config VF610_ADC_1_VREF
			bool "Activate ADC on VREF"
			depends on VF610_ADC_1
			default n
		config VF610_ADC_1_Temp
			bool "Activate Tempatur Sensor"
			depends on VF610_ADC_1
			default n
		config VF610_ADC_1_VREF_PMU
			bool "Activate ADC on VREF at PMU"
			depends on VF610_ADC_1
			default n
```
