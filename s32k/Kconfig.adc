## s32k/Kconfig.adc
```kconfig
#:%s/ADC_CHANNEL(\([0-9]*\), \([0-9]*\), \([A-Z0-9]*\), MODE[0-9]);/\tconfig MACH_S32K_ADC\1_\2\r\t\tbool "Channel \2 (\3)"/gc 
menuconfig MACH_S32K_ADC0
	bool "ADC 0"
if MACH_S32K_ADC0
	choice 
		prompt "ADC Clock"
		config MACH_S32K_ADC0_SPLLDIV2
			bool "SPLLDIV2"
		config MACH_S32K_ADC0_SOSCDIV2
			bool "SOSCDIV2"
		config MACH_S32K_ADC0_SIRCDIV2
			bool "SIRCDIV2"
		config MACH_S32K_ADC0_FIRCDIV2
			bool "FIRCDIV2"
	endchoice
	config MACH_S32K_ADC0_0
		bool "Channel 0 (PTA0)"
	config MACH_S32K_ADC0_1
		bool "Channel 1 (PTA1)"
	config MACH_S32K_ADC0_2
		bool "Channel 2 (PTA6)"
	config MACH_S32K_ADC0_3
		bool "Channel 3 (PTA7)"
	config MACH_S32K_ADC0_4
		bool "Channel 4 (PTB0)"
	config MACH_S32K_ADC0_5
		bool "Channel 5 (PTB1)"
	config MACH_S32K_ADC0_6
		bool "Channel 6 (PTB2)"
	config MACH_S32K_ADC0_7
		bool "Channel 7 (PTB3)"
	config MACH_S32K_ADC0_8
		bool "Channel 8 (PTB13)"
	config MACH_S32K_ADC0_9
		bool "Channel 9 (PTC1)"
	config MACH_S32K_ADC0_10
		bool "Channel 10 (PTC2)"
	config MACH_S32K_ADC0_11
		bool "Channel 11 (PTC3)"
	config MACH_S32K_ADC0_12
		bool "Channel 12 (PTC14)"
	config MACH_S32K_ADC0_13
		bool "Channel 13 (PTC15)"
	config MACH_S32K_ADC0_14
		bool "Channel 14 (PTC16)"
	config MACH_S32K_ADC0_15
		bool "Channel 15 (PTC17)"
endif

menuconfig MACH_S32K_ADC1
	bool "ADC 1"
if MACH_S32K_ADC1
	choice 
		prompt "ADC Clock"
		config MACH_S32K_ADC1_SPLLDIV2
			bool "SPLLDIV2"
		config MACH_S32K_ADC1_SOSCDIV2
			bool "SOSCDIV2"
		config MACH_S32K_ADC1_SIRCDIV2
			bool "SIRCDIV2"
		config MACH_S32K_ADC1_FIRCDIV2
			bool "FIRCDIV2"
	endchoice
	config MACH_S32K_ADC1_0
		bool "Channel 0 (PTA2)"
	config MACH_S32K_ADC1_1
		bool "Channel 1 (PTA3)"
	config MACH_S32K_ADC1_2
		bool "Channel 2 (PTD2)"
	config MACH_S32K_ADC1_3
		bool "Channel 3 (PTD3)"
	config MACH_S32K_ADC1_4
		bool "Channel 4 (PTC6)"
	config MACH_S32K_ADC1_5
		bool "Channel 5 (PTC7)"
	config MACH_S32K_ADC1_6
		bool "Channel 6 (PTD4)"
	config MACH_S32K_ADC1_7
		bool "Channel 7 (PTB12)"
	config MACH_S32K_ADC1_8
		bool "Channel 8 (PTB13)"
	config MACH_S32K_ADC1_9
		bool "Channel 9 (PTB14)"
	config MACH_S32K_ADC1_10
		bool "Channel 10 (PTE2)"
	config MACH_S32K_ADC1_11
		bool "Channel 11 (PTE6)"
	config MACH_S32K_ADC1_12
		bool "Channel 12 (PTA15)"
	config MACH_S32K_ADC1_13
		bool "Channel 13 (PTA16)"
	config MACH_S32K_ADC1_14
		bool "Channel 14 (PTB0)"
	config MACH_S32K_ADC1_15
		bool "Channel 15 (PTB16)"
endif
```

## s32k/Kconfig.can
```kconfig
comment "Waring: Loopback Mode disable physical connection to the CAN Bus!"
	depends on NXP_FLEXCAN_LOOP_BACK_MODE
config NXP_FLEXCAN_LOOP_BACK_MODE
	bool "Activate Loopback Mode (Debug Mode)"
	default n
	help
		Activate Loopback Debug Mode
		All sended messages are also recived
		The real bus is disconeded in this mode!
config NXP_FLEXCAN_DEBUG
	bool "FlexCAN: Debug Support"
	default n
	help
		Add printfs to debug FlexCAN
menuconfig MACH_S32K_FLEXCAN_CAN0
	bool "CAN 0"
	default n
if MACH_S32K_FLEXCAN_CAN0=y
	choice 
		prompt "RX Pin"
		config MACH_S32K_FLEXCAN_CAN0_RX_PTB0
			bool "PTB0"
		config MACH_S32K_FLEXCAN_CAN0_RX_PTC2
			bool "PTC2"
		config MACH_S32K_FLEXCAN_CAN0_RX_PTE4
			bool "PTE4"
		config MACH_S32K_FLEXCAN_CAN0_RX_PTA28
			bool "PTA28"
	endchoice
	choice 
		prompt "TX Pin"
		config MACH_S32K_FLEXCAN_CAN0_TX_PTB1
			bool "PTB1"
		config MACH_S32K_FLEXCAN_CAN0_TX_PTC3
			bool "PTC3"
		config MACH_S32K_FLEXCAN_CAN0_TX_PTE5
			bool "PTE5"
		config MACH_S32K_FLEXCAN_CAN0_TX_PTA27
			bool "PTA27"
	endchoice
	comment "Waring: More than 31 Filter are not posible"
		depends on MACH_S32K_FLEXCAN_CAN0_MAX_FILTER > 31
	config MACH_S32K_FLEXCAN_CAN0_MAX_FILTER
		int "Max Input Filters"
		default 2
	config MACH_S32K_FLEXCAN_CAN0_FILTER_QUEUE_ENTRIES
		int "Max Filter Software Queue Entries"
		default 2
		help
			The Hardware has only one entrie per filter
			so we need a software queue to store the messages

			How manny CAN Frames can be stored in this software queue?
endif
menuconfig MACH_S32K_FLEXCAN_CAN1
	bool "CAN 1"
	default n
	depends on !S32K116
	depends on !S32K118
if MACH_S32K_FLEXCAN_CAN1=y
	choice 
		prompt "RX Pin"
		config MACH_S32K_FLEXCAN_CAN1_RX_PTC6
			bool "PTC6"
		config MACH_S32K_FLEXCAN_CAN1_RX_PTA12
			bool "PTA12"
	endchoice
	choice 
		prompt "TX Pin"
		config MACH_S32K_FLEXCAN_CAN1_TX_PTC7
			bool "PTC7"
		config MACH_S32K_FLEXCAN_CAN1_TX_PTA13
			bool "PTA13"
	endchoice
	comment "Waring: More than 31 Filter are not posible"
		depends on MACH_S32K_FLEXCAN_CAN1_MAX_FILTER > 31
		depends on S32K146 || S32K148
	comment "Waring: More than 15 Filter are not posible"
		depends on MACH_S32K_FLEXCAN_CAN1_MAX_FILTER > 15
		depends on !S32K146
		depends on !S32K148
		depends on S32K144 || S32K142
	config MACH_S32K_FLEXCAN_CAN1_MAX_FILTER
		int "Max Input Filters"
		default 2
	config MACH_S32K_FLEXCAN_CAN1_FILTER_QUEUE_ENTRIES
		int "Max Filter Software Queue Entries"
		default 2
		help
			The Hardware has only one entrie per filter
			so we need a software queue to store the messages

			How manny CAN Frames can be stored in this software queue?
endif
menuconfig MACH_S32K_FLEXCAN_CAN2
	bool "CAN 2"
	default n
	depends on !S32K116
	depends on !S32K118
	depends on !S32K142
if MACH_S32K_FLEXCAN_CAN2=y
	choice 
		prompt "RX Pin"
		config MACH_S32K_FLEXCAN_CAN2_RX_PTB12
			bool "PTB12"
		config MACH_S32K_FLEXCAN_CAN2_RX_PTC16
			bool "PTC16"
		config MACH_S32K_FLEXCAN_CAN2_RX_PTE25
			bool "PTE25"
	endchoice
	choice 
		prompt "TX Pin"
		config MACH_S32K_FLEXCAN_CAN2_TX_PTB13
			bool "PTB13"
		config MACH_S32K_FLEXCAN_CAN2_TX_PTC17
			bool "PTC17"
		config MACH_S32K_FLEXCAN_CAN2_TX_PTE24
			bool "PTE24"
	endchoice
	comment "Waring: More than 31 Filter are not posible"
		depends on MACH_S32K_FLEXCAN_CAN2_MAX_FILTER > 31
		depends on S32K148
	comment "Waring: More than 15 Filter are not posible"
		depends on MACH_S32K_FLEXCAN_CAN2_MAX_FILTER > 15
		depends on !S32K148
		depends on S32K144 || S32K146
	config MACH_S32K_FLEXCAN_CAN2_MAX_FILTER
		int "Max Input Filters"
		default 2
	config MACH_S32K_FLEXCAN_CAN2_FILTER_QUEUE_ENTRIES
		int "Max Filter Software Queue Entries"
		default 2
		help
			The Hardware has only one entrie per filter
			so we need a software queue to store the messages

			How manny CAN Frames can be stored in this software queue?
endif

comment "Selected payload size reduce the number of hadware filter!"
	depends on DISABLED
choice 
	prompt "Select Max Payload Size"
	depends on DISABLED
	config NXP_FLEXCAN_MAX_DLEN_8
		bool "8 Byte (CAN)"
	config NXP_FLEXCAN_MAX_DLEN_16
		bool "16 Byte (CAN FD)"
		depends on CAN_FD
	config NXP_FLEXCAN_MAX_DLEN_32
		bool "32 Byte (CAN FD)"
		depends on CAN_FD
	config NXP_FLEXCAN_MAX_DLEN_64
		bool "64 Byte (CAN FD)"
		depends on CAN_FD
endchoice
```

## s32k/Kconfig.lpuart
```kconfig
choice 
	prompt "RX Buffer useage"
	config MACH_S32K_LPUART_USE_SEMAPHORE
		bool "RX Use Semaphore"
		help
			RX Use Semaphore and get char in userspace

			Posible Overflow on high load but smaler footprint

			Overflows are ignored
	config MACH_S32K_LPUART_USE_QUEUE
		bool "RX Use Queue"
		help
			RX Use Queue and get char in interrupt

			Overflows are ignored!
endchoice
config MACH_S32K_LPUART_QUEUE_LENGTH
	int "Queue Length"
	depends on MACH_S32K_LPUART_USE_QUEUE
	default 8

menuconfig MACH_S32K_LPUART0
	bool "LPUART 0"
if MACH_S32K_LPUART0=y

	choice 
		prompt "UART Clock"
		config MACH_S32K_LPUART0_SPLLDIV2
			bool "SPLLDIV2"
		config MACH_S32K_LPUART0_SOSCDIV2
			bool "SOSCDIV2"
		config MACH_S32K_LPUART0_SIRCDIV2
			bool "SIRCDIV2"
		config MACH_S32K_LPUART0_FIRCDIV2
			bool "FIRCDIV2"
	endchoice
	choice 
		prompt "TX Pin"
		config MACH_S32K_LPUART0_TX_PTC3
			bool "PTC3"
		config MACH_S32K_LPUART0_TX_PTB1
			bool "PTB1"
		config MACH_S32K_LPUART0_TX_PTA3
			bool "PTA3"
	endchoice
	choice 
		prompt "RX Pin"
		config MACH_S32K_LPUART0_RX_PTC2
			bool "PTC2"
		config MACH_S32K_LPUART0_RX_PTB0
			bool "PTB0"
		config MACH_S32K_LPUART0_RX_PTA2
			bool "PTA2"
	endchoice
endif
menuconfig MACH_S32K_LPUART1
	bool "LPUART 1"
if MACH_S32K_LPUART1=y
	choice 
		prompt "UART Clock"
		config MACH_S32K_LPUART1_SPLLDIV2
			bool "SPLLDIV2"
		config MACH_S32K_LPUART1_SOSCDIV2
			bool "SOSCDIV2"
		config MACH_S32K_LPUART1_SIRCDIV2
			bool "SIRCDIV2"
		config MACH_S32K_LPUART1_FIRCDIV2
			bool "FIRCDIV2"
	endchoice
	choice 
		prompt "TX Pin"
		config MACH_S32K_LPUART1_TX_PTC7
			bool "PTC7"
		config MACH_S32K_LPUART1_TX_PTC9
			bool "PTC9"
		config MACH_S32K_LPUART1_TX_PTD17
			bool "PTD17"
	endchoice
	choice 
		prompt "RX Pin"
		config MACH_S32K_LPUART1_RX_PTC6
			bool "PTC6"
		config MACH_S32K_LPUART1_RX_PTC8
			bool "PTC8"
		config MACH_S32K_LPUART1_RX_PTD14
			bool "PTD14"
	endchoice
endif
menuconfig MACH_S32K_LPUART2
	bool "LPUART 2"
if MACH_S32K_LPUART2=y
	choice 
		prompt "UART Clock"
		config MACH_S32K_LPUART2_SPLLDIV2
			bool "SPLLDIV2"
		config MACH_S32K_LPUART2_SOSCDIV2
			bool "SOSCDIV2"
		config MACH_S32K_LPUART2_SIRCDIV2
			bool "SIRCDIV2"
		config MACH_S32K_LPUART2_FIRCDIV2
			bool "FIRCDIV2"
	endchoice
	choice 
		prompt "TX Pin"
		config MACH_S32K_LPUART2_TX_PTE12
			bool "PTE12"
		config MACH_S32K_LPUART2_TX_PTD7
			bool "PTD7"
		config MACH_S32K_LPUART2_TX_PTA9
			bool "PTD9"
	endchoice
	choice 
		prompt "RX Pin"
		config MACH_S32K_LPUART2_RX_PTD17
			bool "PTD17"
		config MACH_S32K_LPUART2_RX_PTD6
			bool "PTD6"
		config MACH_S32K_LPUART2_RX_PTA8
			bool "PTA8"
	endchoice
endif
```

## s32k/Kconfig.spi
```kconfig
config MACH_S32K_LPSPI_MAX_SLAVES
	int "Max Slaves"
	default 1
config MACH_S32K_LPSPI_DEBUG
	bool "SPI Debug Mode"
	default n
menuconfig MACH_S32K_LPSPI0
	bool "LPSPI0"
	default n
if MACH_S32K_LPSPI0
	choice 
		prompt "SPI Clock"
		config MACH_S32K_LPSPI0_SPLLDIV2
			bool "SPLLDIV2"
		config MACH_S32K_LPSPI0_SOSCDIV2
			bool "SOSCDIV2"
		config MACH_S32K_LPSPI0_SIRCDIV2
			bool "SIRCDIV2"
		config MACH_S32K_LPSPI0_FIRCDIV2
			bool "FIRCDIV2"
	endchoice
	choice
		prompt "LPSPI Serial Clock I/O"
		config MACH_S32K_LPSPI0_SCK_PTB2
			bool "PTB2"
		config MACH_S32K_LPSPI0_SCK_PTC23
			bool "PTC23"
		config MACH_S32K_LPSPI0_SCK_PTD15
			bool "PTD15"
		config MACH_S32K_LPSPI0_SCK_PTE0
			bool "PTE0"
	endchoice
	choice
		prompt "LPSPI Serial Data Input"
		config MACH_S32K_LPSPI0_SIN_PTB3
			bool "PTB3"
		config MACH_S32K_LPSPI0_SIN_PTD16
			bool "PTD16"
		config MACH_S32K_LPSPI0_SIN_PTE1
			bool "PTE1"
	endchoice
	choice
		prompt "LPSPI Serial Data Output"
		config MACH_S32K_LPSPI0_SOUT_PTA30
			bool "PTA30"
		config MACH_S32K_LPSPI0_SOUT_PTB1
			bool "PTB1"
		config MACH_S32K_LPSPI0_SOUT_PTB4
			bool "PTB4"
		config MACH_S32K_LPSPI0_SOUT_PTE2
			bool "PTE2"
	endchoice
	choice
		prompt "Peripheral Chip Select 0"
		config MACH_S32K_LPSPI0_PCS0_PTA26
			bool "PTA26"
		config MACH_S32K_LPSPI0_PCS0_PTB0
			bool "PTB0"
		config MACH_S32K_LPSPI0_PCS0_PTB5
			bool "PTB5"
	endchoice
	choice
		prompt "Peripheral Chip Select 1"
		config MACH_S32K_LPSPI0_PCS1_PTA31
			bool "PTA31"
		config MACH_S32K_LPSPI0_PCS1_PTB5
			bool "PTB5"
	endchoice
	choice
		prompt "Peripheral Chip Select 2"
		config MACH_S32K_LPSPI0_PCS2_PTE6
			bool "PTE6"
	endchoice
	choice
		prompt "Peripheral Chip Select 3"
		config MACH_S32K_LPSPI0_PCS3_PTA15
			bool "PTA15"
	endchoice
endif

menuconfig MACH_S32K_LPSPI1
	bool "LPSPI1"
	default n
if MACH_S32K_LPSPI1
	choice 
		prompt "SPI Clock"
		config MACH_S32K_LPSPI1_SPLLDIV2
			bool "SPLLDIV2"
		config MACH_S32K_LPSPI1_SOSCDIV2
			bool "SOSCDIV2"
		config MACH_S32K_LPSPI1_SIRCDIV2
			bool "SIRCDIV2"
		config MACH_S32K_LPSPI1_FIRCDIV2
			bool "FIRCDIV2"
	endchoice
	choice
		prompt "LPSPI Serial Clock I/O"
		config MACH_S32K_LPSPI1_SCK_PTA19
			bool "PTA19"
		config MACH_S32K_LPSPI1_SCK_PTA28
			bool "PTA28"
		config MACH_S32K_LPSPI1_SCK_PTB14
			bool "PTB14"
		config MACH_S32K_LPSPI1_SCK_PTD0
			bool "PTD0"
	endchoice
	choice
		prompt "LPSPI Serial Data Input"
		config MACH_S32K_LPSPI1_SIN_PTA20
			bool "PTA20"
		config MACH_S32K_LPSPI1_SIN_PTA29
			bool "PTA29"
		config MACH_S32K_LPSPI1_SIN_PTB15
			bool "PTB15"
		config MACH_S32K_LPSPI1_SIN_PTD1
			bool "PTD1"
	endchoice
	choice
		prompt "LPSPI Serial Data Output"
		config MACH_S32K_LPSPI1_SOUT_PTA18
			bool "PTA18"
		config MACH_S32K_LPSPI1_SOUT_PTA27
			bool "PTA27"
		config MACH_S32K_LPSPI1_SOUT_PTB16
			bool "PTB16"
		config MACH_S32K_LPSPI1_SOUT_PTD2
			bool "PTD2"
		config MACH_S32K_LPSPI1_SOUT_PTE0
			bool "PTE0"
	endchoice
	choice
		prompt "Peripheral Chip Select 0"
		config MACH_S32K_LPSPI1_PCS0_PTA21
			bool "PTA21"
		config MACH_S32K_LPSPI1_PCS0_PTA26
			bool "PTA26"
		config MACH_S32K_LPSPI1_PCS0_PTD3
			bool "PTD3"
		config MACH_S32K_LPSPI1_PCS0_PTE1
			bool "PTE1"
	endchoice
	choice
		prompt "Peripheral Chip Select 1"
		config MACH_S32K_LPSPI1_PCS1_PTA22
			bool "PTA22"
		config MACH_S32K_LPSPI1_PCS1_PTA6
			bool "PTA6"
		config MACH_S32K_LPSPI1_PCS1_PTB18
			bool "PTB18"
	endchoice
	choice
		prompt "Peripheral Chip Select 2"
		config MACH_S32K_LPSPI1_PCS2_PTA16
			bool "PTA16"
	endchoice
	choice
		prompt "Peripheral Chip Select 3"
		config MACH_S32K_LPSPI1_PCS3_PTB17
			bool "PTB17"
	endchoice
endif

menuconfig MACH_S32K_LPSPI2
	bool "LPSPI2"
	default n
if MACH_S32K_LPSPI2
	choice 
		prompt "SPI Clock"
		config MACH_S32K_LPSPI2_SPLLDIV2
			bool "SPLLDIV2"
		config MACH_S32K_LPSPI2_SOSCDIV2
			bool "SOSCDIV2"
		config MACH_S32K_LPSPI2_SIRCDIV2
			bool "SIRCDIV2"
		config MACH_S32K_LPSPI2_FIRCDIV2
			bool "FIRCDIV2"
	endchoice
	choice
		prompt "LPSPI Serial Clock I/O"
		config MACH_S32K_LPSPI2_SCK_PTB29
			bool "PTB29"
		config MACH_S32K_LPSPI2_SCK_PTC15
			bool "PTC15"
		config MACH_S32K_LPSPI2_SCK_PTE15
			bool "PTE15"
	endchoice
	choice
		prompt "LPSPI Serial Data Input"
		config MACH_S32K_LPSPI2_SIN_PTB28
			bool "PTB28"
		config MACH_S32K_LPSPI2_SIN_PTC0
			bool "PTC0"
		config MACH_S32K_LPSPI2_SIN_PTE16
			bool "PTE16"
	endchoice
	choice
		prompt "LPSPI Serial Data Output"
		config MACH_S32K_LPSPI2_SOUT_PTA8
			bool "PTA8"
		config MACH_S32K_LPSPI2_SOUT_PTB27
			bool "PTB27"
		config MACH_S32K_LPSPI2_SOUT_PTC1
			bool "PTC1"
	endchoice
	choice
		prompt "Peripheral Chip Select 0"
		config MACH_S32K_LPSPI2_PCS0_PTA9
			bool "PTA9"
		config MACH_S32K_LPSPI2_PCS0_PTB25
			bool "PTB25"
		config MACH_S32K_LPSPI2_PCS0_PTC14
			bool "PTC14"
		config MACH_S32K_LPSPI2_PCS0_PTE11
			bool "PTE11"
	endchoice
	choice
		prompt "Peripheral Chip Select 1"
		config MACH_S32K_LPSPI2_PCS1_PTC19
			bool "PTC19"
		config MACH_S32K_LPSPI2_PCS1_PTE10
			bool "PTE10"
	endchoice
	choice
		prompt "Peripheral Chip Select 2"
		config MACH_S32K_LPSPI2_PCS2_PTE13
			bool "PTE13"
	endchoice
	choice
		prompt "Peripheral Chip Select 3"
		config MACH_S32K_LPSPI2_PCS3_PTA15
			bool "PTA15"
	endchoice
endif
```
