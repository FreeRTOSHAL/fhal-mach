## stm32/Kconfig
```kconfig
comment "Ti STM32 Settings"
choice 
	prompt "Select Prozessor Type"
	config STM32_F0
		bool "STM32 F0xxx"
		depends on ARCH_ARM_CORTEX_M0
	config STM32_F2
		bool "STM32 F3xxxx"
		depends on ARCH_ARM_CORTEX_M3
	config STM32_F4
		bool "STM32 F4xxxx"
		depends on ARCH_ARM_CORTEX_M3 || ARCH_ARM_CORTEX_M4F
endchoice
if STM32_F0=y
	choice
		prompt "Select Prozessor"
		config STM32F030
			bool "STM32F030"
		config STM32F031
			bool "STM32F031"
		config STM32F051
			bool "STM32F051"
		config STM32F072
			bool "STM32F072"
		config STM32F070xB
			bool "STM32F070xB"
		config STM32F042
			bool "STM32F042"
		config STM32F070x6
			bool "STM32F070x6"
		config STM32F091
			bool "STM32F091"
		config STM32F030xC
			bool "STM32F030xC"
	endchoice
	config STM32_TIMER_M0
		bool
		default y
endif
if STM32_F0=n
	config STM32_TIMER_M3_4
		bool
		default y
endif
if STM32_F2=y
	choice
		prompt "Select Prozessor"
		config STM32F2XX
			bool "STM32F2XX"
	endchoice
endif
config SPARK_PHOTON
	depends on STM32F2XX
	bool "Spark Photon"
	help
		Spark Phton Support

if STM32_F4=y
	choice
		prompt "Select Prozessor"
		config STM32F40_41xxx
			bool "STM32F40_41xxx"
		config STM32F427_437xx
			bool "STM32F427_437xx"
		config STM32F429_439xx
			bool "STM32F429_439xx"
		config STM32F401xx
			bool "STM32F401xx"
		config STM32F410xx
			bool "STM32F410xx"
		config STM32F411xE
			bool "STM32F411xE"
		config STM32F446xx
			bool "STM32F446xx"
		config STM32F469_479xx
			bool "STM32F469_479xx"
	endchoice
endif
choice
	prompt "Flash Size"
	config STM32_8K
		bool "8K Flash"
	config STM32_16K
		bool "16K Flash"
	config STM32_32K
		bool "32K Flash"
	config STM32_64K
		bool "64K Flash"
	config STM32_128K
		bool "128K Flash"
		depends on STM32F401xx || STM32F2XX
	config STM32_192K
		bool "192K Flash"
	config STM32_256K
		bool "256K Flash"
		depends on STM32F401xx || STM32F2XX
	config STM32_384K
		bool "384K Flash"
		depends on STM32F401xx
	config STM32_512K
		bool "512K Flash"
		depends on STM32F401xx || STM32F2XX || STM32F40_41xxx
	config STM32_768K
		bool "768K Flash"
		depends on STM32F2XX
	config STM32_1M
		bool "1M Flash"
		depends on STM32F2XX || STM32F40_41xxx
	config STM32_2M
		bool "2M Flash"
endchoice
choice
	prompt "RAM Size"
	config STM32_RAM_2K
		bool "2K RAM"
	config STM32_RAM_4K
		bool "4K RAM"
	config STM32_RAM_6K
		bool "6K RAM"
	config STM32_RAM_8K
		bool "8K RAM"
	config STM32_RAM_10K
		bool "10K RAM"
	config STM32_RAM_16K
		bool "16K RAM"
	config STM32_RAM_20K
		bool "20K RAM"
	config STM32_RAM_24K
		bool "24K RAM"
	config STM32_RAM_32K
		bool "32K RAM"
	config STM32_RAM_40K
		bool "40K RAM"
	config STM32_RAM_48K
		bool "48K RAM"
	config STM32_RAM_64K
		bool "64K RAM"
		depends on STM32F401xx || STM32F2XX
	config STM32_RAM_80K
		bool "80K RAM"
	config STM32_RAM_96K
		bool "96K RAM"
		depends on STM32F401xx || STM32F2XX
	config STM32_RAM_128K
		bool "128K RAM"
		depends on STM32F2XX || STM32F40_41xxx
	config STM32_RAM_192K
		bool "192K RAM"
	config STM32_RAM_256K
		bool "256K RAM"
	config STM32_RAM_320K
		bool "320K RAM"
	config STM32_RAM_384K
		bool "384K RAM"
	config STM32_RAM_512K
		bool "512K RAM"
endchoice
config SYSTICK_USE_EXTERNAL
	bool "Systick Use External Source"
	default n
	help
		Systick use the External Source

		The External Source is the CPU Clock deviated by 8

		configSYSTICK_CLOCK_HZ is set Automatically 

		FreeRTOS Docu:

		When SysTick is clocked at the core speed...

		Most Cortex-M microcontrollers clock the SysTick timer at the same frequency as the Cortex-M core. 
		When this is the case, the combination of high clock speed and 24-bit resolution result in a sever 
		limitation in the maximum tickless period that can be achieved. To achieve very high power saving 
		gains it is necessary to override the built in tickless idle implementation with an implementation 
		that uses an alternative time source.
		If the SysTick timer frequency equals the core frequency then configSYSTICK_CLOCK_HZ must be 
		defined to equal configCPU_CLOCK_HZ in FreeRTOSConfig.h. Alternatively, a definition for 
		configSYSTICK_CLOCK_HZ can just be omitted, in which case it will default to equal 
		configCPU_CLOCK_HZ.


		When SysTick is clocked below the core speed...

		The maximum tickless period that can be achieved increases dramatically when the frequency of the 
		SysTick timer is less than the frequency of the core.
		If the SysTick timer frequency does not equal the core frequency then configSYSTICK_CLOCK_HZ must 
		be defined in FreeRTOSConfig.h to equal the SysTick frequency (in Hz).


if SYSTICK_USE_EXTERNAL
config SYSTICK_HZ_DIV
	int 
	default 8
endif
config MAX_SYSCALL_INTERRUPT_PRIORITY
	hex
	default 0x20
config KERNEL_INTERRUPT_PRIORITY 
	hex
	default 0xf0
config MACH_LD_SCRIPT
	string 
	default "mach/stm32/stm32.lds"
if STM32_F0=y
	config MACH_INCLUDE
		string
		default "-Imach/stm32/include -Imach/stm32/st_periph_driver_f0/include/"
endif
if STM32_F2=y
	config MACH_INCLUDE
		string
		default "-Imach/stm32/include -Imach/stm32/st_periph_driver_f2/include/"
endif
if STM32_F4=y
	config MACH_INCLUDE
		string
		default "-Imach/stm32/include -Imach/stm32/st_periph_driver_f4/include/"
endif
config MACH_DEFINE_HEAP
	bool
	default y
if STM32_F2=y || STM32_F4=y
config STM32_CLOCK_BIG
	bool
	default y
endif
if STM32_F0=y
config STM32_CLOCK_SMALL
	bool
	default y
endif
config MACH_USE_GENERIC_FAULT_HANDLER
	bool
	depends on ARCH_ARM_CORTEX_M3 || ARCH_ARM_CORTEX_M4F
	default y

config MACH_INIT_STACK_SIZE
	int "Init Stack Size"
	default 600
	help
		Stack Size of Init Prozess. Stack size used by Interrupt and Init Prozess
config MACH_HAS_UART
	bool
	default y
config MACH_HAS_GPIO
	bool
	default y
config MACH_HAS_NEWLIB
	bool
	default y
config MACH_HAS_NVIC
	bool
	default y
config MACH_HAS_TIMER
	bool
	default y
config MACH_HAS_PWM
	bool
	default y
config MACH_HAS_CAPTURE
	bool
	default y
config MACH_HAS_SPI
	bool
	default y
config MACH_HAS_SDIO
	bool
	depends on !STM32_F0
	default y
comment "PLL Settings"
menuconfig EXTERNEL_OSCILLATOR
	bool "Activate External Cristal Oscillator"
	depends on !STM32_F0
	comment "PLL Settings"
		depends on EXTERNEL_OSCILLATOR
	comment "Waring: PLL Setting could damage Target" 
		depends on EXTERNEL_OSCILLATOR
	config HSE_HZ
		int "Externel Oszilator Speed (Hz)"
		depends on EXTERNEL_OSCILLATOR
		default 25000000
		help
			Externel Oszilator Settings
	config PLLM
		int "PLLM"
		depends on EXTERNEL_OSCILLATOR
		default 25
		help
			PLLM Setting
	config PLLN
		int "PLLN"
		depends on EXTERNEL_OSCILLATOR
		default 336
		help
			PLLN Setting
	config PLLP
		int "PLLP"
		depends on EXTERNEL_OSCILLATOR
		default 4
		help
			PLLP Setting
	config PLLQ
		int "PLLQ"
		depends on EXTERNEL_OSCILLATOR
		default 7
		help
			PLLQ Setting
	config PLLR
		int "PLLR"
		depends on EXTERNEL_OSCILLATOR
		depends on STM32F410xx || STM32F446xx || STM32F469_479xx
		default 1
		help
			PLLR Setting
	choice
		prompt "Select Main Regulator Mode"
		depends on EXTERNEL_OSCILLATOR
		config VOS_SCALE_2
			bool "Regulator voltage output Scale 2 mode"
		config VOS_SCALE_3
			bool "Regulator voltage output Scale 3 mode"
		config VOS_SCALE_1
			bool "Regulator voltage output Scale 1 mode"
	endchoice
	choice
		prompt "Select Flash Latency"
		depends on EXTERNEL_OSCILLATOR
		config FLASH_LATENCY_0
			bool "Flash Latency 0"
		config FLASH_LATENCY_1
			bool "Flash Latency 1"
		config FLASH_LATENCY_2
			bool "Flash Latency 2"
		config FLASH_LATENCY_3
			bool "Flash Latency 3"
		config FLASH_LATENCY_4
			bool "Flash Latency 4"
		config FLASH_LATENCY_5
			bool "Flash Latency 5"
		config FLASH_LATENCY_6
			bool "Flash Latency 6"
		config FLASH_LATENCY_7
			bool "Flash Latency 7"
		config FLASH_LATENCY_8
			bool "Flash Latency 8"
		config FLASH_LATENCY_9
			bool "Flash Latency 9"
		config FLASH_LATENCY_10
			bool "Flash Latency 10"
		config FLASH_LATENCY_10
			bool "Flash Latency 10"
		config FLASH_LATENCY_11
			bool "Flash Latency 11"
		config FLASH_LATENCY_12
			bool "Flash Latency 12"
		config FLASH_LATENCY_13
			bool "Flash Latency 13"
		config FLASH_LATENCY_14
			bool "Flash Latency 14"
		config FLASH_LATENCY_15
			bool "Flash Latency 15"
	endchoice
	choice
		prompt "Seect Sysclk Div"
		depends on EXTERNEL_OSCILLATOR
		config SYSCLK_DIV_1
			bool "Sysclk div 1"
		config SYSCLK_DIV_2
			bool "Sysclk div 2"
		config SYSCLK_DIV_4
			bool "Sysclk div 4"
		config SYSCLK_DIV_8
			bool "Sysclk div 8"
		config SYSCLK_DIV_16
			bool "Sysclk div 16"
		config SYSCLK_DIV_64
			bool "Sysclk div 64"
		config SYSCLK_DIV_128
			bool "Sysclk div 128"
		config SYSCLK_DIV_256
			bool "Sysclk div 256"
		config SYSCLK_DIV_512
			bool "Sysclk div 512"
	endchoice
	choice
		prompt "Low Speed APB clock (APB1 Clock) Div"
		depends on EXTERNEL_OSCILLATOR
		config PCLK1_DIV_2
			bool "APB1 Clock Div 2"
		config PCLK1_DIV_4
			bool "APB1 Clock Div 4"
		config PCLK1_DIV_8
			bool "APB1 Clock Div 8"
		config PCLK1_DIV_16
			bool "APB1 Clock Div 16"
		config PCLK1_DIV_1
			bool "APB1 Clock Div 1 (Warring see max Speed)"
	endchoice
	choice
		prompt "High Speed APB clock (APB2 Clock) Div"
		depends on EXTERNEL_OSCILLATOR
		config PCLK2_DIV_2
			bool "APB2 Clock Div 2"
		config PCLK2_DIV_4
			bool "APB2 Clock Div 4"
		config PCLK2_DIV_8
			bool "APB2 Clock Div 8"
		config PCLK2_DIV_16
			bool "APB2 Clock Div 16"
		config PCLK2_DIV_1
			bool "APB2 Clock Div 1 (Warring see max Speed)"
	endchoice
comment "Periphery Setting"
config STM32_MUX
	bool
	default y
	select GPIO
	help
		GPIO is needet for muxing
source mach/stm32/Kconfig.uart
source mach/stm32/Kconfig.timer
config STM32_DMA
	bool 
	default n
	help
		SDIO Driver
config STM32_SDIO
	bool "SDIO Driver"
	default n
	depends on SD
	select STM32_DMA
	help
		SDIO Driver
```

## stm32/Kconfig.spi
```kconfig
menuconfig STM32_SPI
	bool "SPI"
	depends on SPI
if STM32_SPI
	menuconfig STM32_SPI_1
		bool "Activate SPI 1"
		if STM32_SPI_1
			choice
				prompt "MISO Pin"
				config STM32_SPI_1_MISO_PTA6
					bool "MISO on PTA6"
				config STM32_SPI_1_MISO_PTB4
					bool "MISO on PTB4"
			endchoice
			choice
				prompt "MOSI Pin"
				config STM32_SPI_1_MOSI_PTA7
					bool "MOSI on PTA7"
				config STM32_SPI_1_MOSI_PTB5
					bool "MOSI on PTB5"
			endchoice
			choice
				prompt "CLK Pin"
				config STM32_SPI_1_CLK_PTA5
					bool "CLK on PTA5"
				config STM32_SPI_1_CLK_PTB3
					bool "CLK on PTB3"
			endchoice
			choice
				prompt "CLK NSS"
				config STM32_SPI_1_NSS_PTA4
					bool "NSS on PTA4"
				config STM32_SPI_1_NSS_PTA15
					bool "NSS on PTA15"
			endchoice
		endif
	menuconfig STM32_SPI_2
		bool "Activate SPI 2"
		if STM32_SPI_2
			choice
				prompt "MISO Pin"
				config STM32_SPI_2_MISO_PTB14
					bool "MISO on PTB14"
				config STM32_SPI_2_MISO_PTC2
					bool "MISO on PTC2"
				config STM32_SPI_2_MISO_PTI2
					bool "MISO on PTC2"
			endchoice
			choice
				prompt "MOSI Pin"
				config STM32_SPI_2_MOSI_PTB15
					bool "MOSI on PTB15"
				config STM32_SPI_2_MOSI_PTC3
					bool "MOSI on PTC3"
				config STM32_SPI_2_MOSI_PTI3
					bool "MOSI on PTI3"
			endchoice
			choice
				prompt "CLK Pin"
				config STM32_SPI_2_CLK_PTB10
					bool "CLK on PTB10"
				config STM32_SPI_2_CLK_PTB13
					bool "CLK on PTB13"
				config STM32_SPI_2_CLK_PTI1
					bool "CLK on PTI1"
			endchoice
			choice
				prompt "CLK NSS"
				config STM32_SPI_2_NSS_PTB9
					bool "NSS on PTB9"
				config STM32_SPI_2_NSS_PTB12
					bool "NSS on PTB12"
				config STM32_SPI_2_NSS_PTI0
					bool "NSS on PTI0"
			endchoice
		endif
	menuconfig STM32_SPI_3
		bool "Activate SPI 3"
		if STM32_SPI_3
			choice
				prompt "MISO Pin"
				config STM32_SPI_3_MISO_PTB4
					bool "MISO on PTB4"
				config STM32_SPI_3_MISO_PTC11
					bool "MISO on PTC11"
			endchoice
			choice
				prompt "MOSI Pin"
				config STM32_SPI_3_MOSI_PTB5
					bool "MOSI on PTB5"
				config STM32_SPI_3_MOSI_PTC12
					bool "MOSI on PTC12"
			endchoice
			choice
				prompt "CLK Pin"
				config STM32_SPI_3_CLK_PTB3
					bool "CLK on PTB3"
				config STM32_SPI_3_CLK_PTC10
					bool "CLK on PTC10"
			endchoice
			choice
				prompt "CLK NSS"
				config STM32_SPI_3_NSS_PTA4
					bool "NSS on PTA4"
				config STM32_SPI_3_NSS_PTA15
					bool "NSS on PTA15"
			endchoice
		endif

endif
```
